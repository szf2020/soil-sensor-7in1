/**
 * @file routes_data.cpp
 * @brief ╨£╨░╤Ç╤ê╤Ç╤â╤é╤ï ╨┤╨╗╤Å ╤Ç╨░╨▒╨╛╤é╤ï ╤ü ╨┤╨░╨╜╨╜╤ï╨╝╨╕ ╨┤╨░╤é╤ç╨╕╨║╨░
 * @details ╨₧╨▒╤Ç╨░╨▒╨╛╤é╨║╨░ ╨╖╨░╨┐╤Ç╨╛╤ü╨╛╨▓ ╨┐╨╛╨║╨░╨╖╨░╨╜╨╕╨╣ ╨┤╨░╤é╤ç╨╕╨║╨░, JSON API ╨╕ ╨▓╨╡╨▒-╨╕╨╜╤é╨╡╤Ç╤ä╨╡╨╣╤ü╨░ ╨┤╨░╨╜╨╜╤ï╤à
 */

#include <ArduinoJson.h>
#include <LittleFS.h>
#include <NTPClient.h>
#include <ctime>
#include "../../include/jxct_config_vars.h"
#include "../../include/jxct_constants.h"
#include "../../include/jxct_format_utils.h"
#include "../../include/jxct_strings.h"
#include "../../include/jxct_ui_system.h"
#include "../../include/logger.h"
#include "../../include/web/csrf_protection.h"  // ≡ƒöÆ CSRF ╨╖╨░╤ë╨╕╤é╨░
#include "../../include/web_routes.h"
#include "../modbus_sensor.h"
#include "../wifi_manager.h"
#include "business_services.h"
#include "calibration_manager.h"
#include "../../include/advanced_filters.h"
#include "../business/sensor_calibration_service.h"

// ╨ô╨╗╨╛╨▒╨░╨╗╤î╨╜╤ï╨╣ ╤ì╨║╨╖╨╡╨╝╨┐╨╗╤Å╤Ç ╤ü╨╡╤Ç╨▓╨╕╤ü╨░ ╨║╨░╨╗╨╕╨▒╤Ç╨╛╨▓╨║╨╕
extern SensorCalibrationService gCalibrationService;

extern NTPClient* timeClient;

// ╨Æ╨╜╨╡╤ê╨╜╨╕╨╡ ╨╖╨░╨▓╨╕╤ü╨╕╨╝╨╛╤ü╤é╨╕ (╤â╨╢╨╡ ╨╛╨▒╤è╤Å╨▓╨╗╨╡╨╜╤ï ╨▓ ╨╖╨░╨│╨╛╨╗╨╛╨▓╨╛╤ç╨╜╤ï╤à ╤ä╨░╨╣╨╗╨░╤à)
// extern String navHtml();  // ╨╛╨▒╤è╤Å╨▓╨╗╨╡╨╜╨╛ ╨▓ wifi_manager.h
// extern String formatValue(float value, const char* unit, int precision);  // ╨╛╨▒╤è╤Å╨▓╨╗╨╡╨╜╨╛ ╨▓ jxct_format_utils.h
// extern String getApSsid();  // ╨╛╨▒╤è╤Å╨▓╨╗╨╡╨╜╨╛ ╨▓ wifi_manager.h

// ╨æ╤â╤ä╨╡╤Ç ╨┤╨╗╤Å ╨╖╨░╨│╤Ç╤â╨╖╨║╨╕ ╤ä╨░╨╣╨╗╨╛╨▓ (╨║╨░╨╗╨╕╨▒╤Ç╨╛╨▓╨║╨░ ╤ç╨╡╤Ç╨╡╨╖ /readings)
namespace
{
File uploadFile;
SoilProfile uploadProfile = SoilProfile::SAND;

// ╨ÿ╤ü╨┐╨╛╨╗╤î╨╖╤â╨╡╨╝ RecValues ╨╕╨╖ ╨▒╨╕╨╖╨╜╨╡╤ü-╤ü╨╡╤Ç╨▓╨╕╤ü╨░

// ╨ñ╤â╨╜╨║╤å╨╕╨╕ ╤ü╨╡╨╖╨╛╨╜╨╜╨╛╨╣ ╨║╨╛╤Ç╤Ç╨╡╨║╤å╨╕╨╕ NPK ╨┐╨╡╤Ç╨╡╨╜╨╡╤ü╨╡╨╜╤ï ╨▓ ╨▒╨╕╨╖╨╜╨╡╤ü-╤ü╨╡╤Ç╨▓╨╕╤ü CropRecommendationEngine

RecValues computeRecommendations()
{
    // ╨ÿ╤ü╨┐╨╛╨╗╤î╨╖╤â╨╡╨╝ ╨▒╨╕╨╖╨╜╨╡╤ü-╤ü╨╡╤Ç╨▓╨╕╤ü ╨┤╨╗╤Å ╨▓╤ï╤ç╨╕╤ü╨╗╨╡╨╜╨╕╤Å ╤Ç╨╡╨║╨╛╨╝╨╡╨╜╨┤╨░╤å╨╕╨╣
    const String cropId = String(config.cropId);

    // ╨ƒ╤Ç╨╡╨╛╨▒╤Ç╨░╨╖╤â╨╡╨╝ ╨║╨╛╨╜╤ä╨╕╨│╤â╤Ç╨░╤å╨╕╤Ä ╨▓ ╤é╨╕╨┐╤ï ╨▒╨╕╨╖╨╜╨╡╤ü-╨╗╨╛╨│╨╕╨║╨╕
    SoilProfile soilProfile = SoilProfile::SAND;
    EnvironmentType envType = EnvironmentType::OUTDOOR;

    // ╨ÿ╤ü╨┐╨╛╨╗╤î╨╖╤â╨╡╨╝ ╨╝╨░╤ü╤ü╨╕╨▓╤ï ╨┤╨╗╤Å ╤â╤ü╤é╤Ç╨░╨╜╨╡╨╜╨╕╤Å ╨┤╤â╨▒╨╗╨╕╤Ç╨╛╨▓╨░╨╜╨╕╤Å ╨║╨╛╨┤╨░
    static const std::array<SoilProfile, 5> soilProfiles = {{
        SoilProfile::SAND,     // 0
        SoilProfile::LOAM,     // 1
        SoilProfile::PEAT,     // 2
        SoilProfile::CLAY,     // 3
        SoilProfile::SANDPEAT  // 4
    }};

    static const std::array<EnvironmentType, 3> envTypes = {{
        EnvironmentType::OUTDOOR,     // 0
        EnvironmentType::GREENHOUSE,  // 1
        EnvironmentType::INDOOR       // 2
    }};

    const int soilIndex = (config.soilProfile >= 0 && config.soilProfile < 5) ? config.soilProfile : 0;
    const int envIndex = (config.environmentType >= 0 && config.environmentType < 3) ? config.environmentType : 0;

    soilProfile = soilProfiles[soilIndex];
    envType = envTypes[envIndex];

    // ╨ƒ╨╛╨╗╤â╤ç╨░╨╡╨╝ ╤Ç╨╡╨║╨╛╨╝╨╡╨╜╨┤╨░╤å╨╕╨╕ ╨╛╤é ╨▒╨╕╨╖╨╜╨╡╤ü-╤ü╨╡╤Ç╨▓╨╕╤ü╨░
    RecValues rec = getCropEngine().computeRecommendations(cropId, soilProfile, envType);

    // ╨ƒ╤Ç╨╕╨╝╨╡╨╜╤Å╨╡╨╝ ╤ü╨╡╨╖╨╛╨╜╨╜╤â╤Ä ╨║╨╛╤Ç╤Ç╨╡╨║╤å╨╕╤Ä ╨╡╤ü╨╗╨╕ ╨▓╨║╨╗╤Ä╤ç╨╡╨╜╨░
    if (config.flags.seasonalAdjustEnabled)
    {
        time_t now = time(nullptr);
        struct tm* timeInfo = localtime(&now);
        const int month = timeInfo != nullptr ? timeInfo->tm_mon + 1 : 1;

        // ╨₧╨┐╤Ç╨╡╨┤╨╡╨╗╤Å╨╡╨╝ ╤ü╨╡╨╖╨╛╨╜
        Season season = Season::WINTER;
        if (month >= 3 && month <= 5)
            season = Season::SPRING;
        else if (month >= 6 && month <= 8)
            season = Season::SUMMER;
        else if (month >= 9 && month <= 11)
            season = Season::AUTUMN;
        else
            season = Season::WINTER;

        const bool isGreenhouse = (config.environmentType == 1);
        getCropEngine().applySeasonalCorrection(rec, season, isGreenhouse);
    }

    return rec;
}
}  // namespace

void handleReadingsUpload()  // Γ£à ╨ú╨▒╨╕╤Ç╨░╨╡╨╝ static - ╤ä╤â╨╜╨║╤å╨╕╤Å extern ╨▓ header
{
    HTTPUpload& upload = webServer.upload();
    if (upload.status == UPLOAD_FILE_START)
    {
        CalibrationManager::init();
        const char* path = CalibrationManager::profileToFilename(SoilProfile::SAND);  // custom.csv
        uploadFile = LittleFS.open(path, "w");
        if (!uploadFile)
        {
            logErrorSafe("\1", path);
        }
    }
    else if (upload.status == UPLOAD_FILE_WRITE)
    {
        if (uploadFile)
        {
            uploadFile.write(upload.buf, upload.currentSize);
        }
    }
    else if (upload.status == UPLOAD_FILE_END)
    {
        if (uploadFile)
        {
            uploadFile.close();
            logSuccessSafe("\1", upload.totalSize);
        }
        webServer.sendHeader("Location", "/readings?toast=╨Ü╨░╨╗╨╕╨▒╤Ç╨╛╨▓╨║╨░+╨╖╨░╨│╤Ç╤â╨╢╨╡╨╜╨░", true);
        webServer.send(HTTP_REDIRECT, "text/plain", "Redirect");
    }
}

namespace
{
void handleProfileSave()
{
    if (webServer.hasArg("soil_profile"))
    {
        const String profileStr = webServer.arg("soil_profile");
        if (profileStr == "sand")
        {
            config.soilProfile = 0;
        }
        else if (profileStr == "loam")
        {
            config.soilProfile = 1;
        }
        else if (profileStr == "peat")
        {
            config.soilProfile = 2;
        }
        else if (profileStr == "clay")
        {
            config.soilProfile = 3;
        }

        saveConfig();
        logSuccessSafe("\1", profileStr.c_str());
    }
    webServer.sendHeader("Location", "/readings?toast=╨ƒ╤Ç╨╛╤ä╨╕╨╗╤î+╤ü╨╛╤à╤Ç╨░╨╜╨╡╨╜", true);
    webServer.send(HTTP_REDIRECT, "text/plain", "Redirect");
}
}  // namespace

void sendSensorJson()  // Γ£à ╨ú╨▒╨╕╤Ç╨░╨╡╨╝ static - ╤ä╤â╨╜╨║╤å╨╕╤Å extern ╨▓ header
{
    // unified JSON response for sensor data
    logWebRequest("GET", webServer.uri(), webServer.client().remoteIP().toString());
    if (currentWiFiMode != WiFiMode::STA)
    {
        webServer.send(HTTP_FORBIDDEN, HTTP_CONTENT_TYPE_JSON, R"({"error":"AP mode"})");
        return;
    }

    StaticJsonDocument<SENSOR_JSON_DOC_SIZE> doc;
    doc["temperature"] = format_temperature(sensorData.temperature);
    doc["humidity"] = format_moisture(sensorData.humidity);
    doc["ec"] = format_ec(sensorData.ec);
    doc["ph"] = format_ph(sensorData.ph);
    doc["nitrogen"] = format_npk(sensorData.nitrogen);
    doc["phosphorus"] = format_npk(sensorData.phosphorus);
    doc["potassium"] = format_npk(sensorData.potassium);
    doc["raw_temperature"] = format_temperature(sensorData.raw_temperature);
    doc["raw_humidity"] = format_moisture(sensorData.raw_humidity);
    doc["raw_ec"] = format_ec(sensorData.raw_ec);
    doc["raw_ph"] = format_ph(sensorData.raw_ph);
    doc["raw_nitrogen"] = format_npk(sensorData.raw_nitrogen);
    doc["raw_phosphorus"] = format_npk(sensorData.raw_phosphorus);
    doc["raw_potassium"] = format_npk(sensorData.raw_potassium);
    doc["irrigation"] = sensorData.recentIrrigation;
    doc["valid"] = validateSensorData(sensorData);  // ╨ñ╨╗╨░╨│ ╨▓╨░╨╗╨╕╨┤╨╜╨╛╤ü╤é╨╕ ╨┐╨╛ ╨╗╨╕╨╝╨╕╤é╨░╨╝ ╨┤╨░╤é╤ç╨╕╨║╨░

    const RecValues rec = computeRecommendations();
    doc["rec_temperature"] = format_temperature(rec.t);
    doc["rec_humidity"] = format_moisture(rec.hum);
    doc["rec_ec"] = format_ec(rec.ec);
    doc["rec_ph"] = format_ph(rec.ph);
    doc["rec_nitrogen"] = format_npk(rec.n);
    doc["rec_phosphorus"] = format_npk(rec.p);
    doc["rec_potassium"] = format_npk(rec.k);

    // ---- ╨ö╨╛╨┐╨╛╨╗╨╜╨╕╤é╨╡╨╗╤î╨╜╨░╤Å ╨╕╨╜╤ä╨╛╤Ç╨╝╨░╤å╨╕╤Å ----
    // ╨í╨╡╨╖╨╛╨╜ ╨┐╨╛ ╤é╨╡╨║╤â╤ë╨╡╨╝╤â ╨╝╨╡╤ü╤Å╤å╤â
    const char* seasonName = []()
    {
        // ╨ƒ╤Ç╨╛╨▓╨╡╤Ç╤Å╨╡╨╝ ╨╕╨╜╨╕╤å╨╕╨░╨╗╨╕╨╖╨░╤å╨╕╤Ä NTP
        if (timeClient == nullptr)
        {
            extern WiFiUDP ntpUDP;
            timeClient = new NTPClient(ntpUDP, "pool.ntp.org", 0, 3600000);
            timeClient->begin();
        }

        time_t now = timeClient ? (time_t)timeClient->getEpochTime() : time(nullptr);
        // ╨╡╤ü╨╗╨╕ ╨▓╤Ç╨╡╨╝╤Å < 2000-01-01 ╤ü╤ç╨╕╤é╨░╨╡╨╝, ╤ç╤é╨╛ NTP ╨╡╤ë╤æ ╨╜╨╡ ╤ü╨╕╨╜╤à╤Ç╨╛╨╜╨╕╨╖╨╕╤Ç╨╛╨▓╨░╨╜
        if (now < NTP_TIMESTAMP_2000)
        {
            // ╨ƒ╤Ç╨╛╨▒╤â╨╡╨╝ ╨╛╨▒╨╜╨╛╨▓╨╕╤é╤î NTP
            if (timeClient)
            {
                timeClient->forceUpdate();
                now = (time_t)timeClient->getEpochTime();
                if (now < NTP_TIMESTAMP_2000)
                {
                    return "╨¥/╨ö";
                }
            }
            else
            {
                return "╨¥/╨ö";
            }
        }
        struct tm* timeInfo = localtime(&now);
        if (!timeInfo)
        {
            return "╨¥/╨ö";
        }
        uint8_t month = timeInfo->tm_mon + 1;
        if (month == 12 || month == 1 || month == 2)
        {
            return "╨ù╨╕╨╝╨░";
        }
        if (month >= 3 && month <= 5)
        {
            return "╨Æ╨╡╤ü╨╜╨░";
        }
        if (month >= 6 && month <= 8)
        {
            return "╨¢╨╡╤é╨╛";
        }
        return "╨₧╤ü╨╡╨╜╤î";
    }();
    doc["season"] = seasonName;

    // ╨ƒ╤Ç╨╛╨▓╨╡╤Ç╤Å╨╡╨╝ ╨╛╤é╨║╨╗╨╛╨╜╨╡╨╜╨╕╤Å
    String alerts = "";
    auto append = [&](const char* n)
    {
        if (alerts.length())
        {
            alerts += ", ";
        }
        alerts += n;
    };
    // ╨ñ╨╕╨╖╨╕╤ç╨╡╤ü╨║╨╕╨╡ ╨┐╤Ç╨╡╨┤╨╡╨╗╤ï ╨┤╨░╤é╤ç╨╕╨║╨░
    if (sensorData.temperature < TEMP_MIN_VALID || sensorData.temperature > TEMP_MAX_VALID)
    {
        append("T");
    }
    if (sensorData.humidity < HUM_MIN_VALID || sensorData.humidity > HUM_MAX_VALID)
    {
        append("╬╕");
    }
    if (sensorData.ec < 0 || sensorData.ec > EC_MAX_VALID)
    {
        append("EC");
    }
    if (sensorData.ph < 3 || sensorData.ph > 9)
    {
        append("pH");
    }
    if (sensorData.nitrogen < 0 || sensorData.nitrogen > NPK_MAX_VALID)
    {
        append("N");
    }
    if (sensorData.phosphorus < 0 || sensorData.phosphorus > NPK_MAX_VALID)
    {
        append("P");
    }
    if (sensorData.potassium < 0 || sensorData.potassium > NPK_MAX_VALID)
    {
        append("K");
    }
    doc["alerts"] = alerts;

    doc["timestamp"] = (long)(timeClient != nullptr ? timeClient->getEpochTime() : 0);

    String json;
    serializeJson(doc, json);
    webServer.send(HTTP_OK, HTTP_CONTENT_TYPE_JSON, json);
}

void setupDataRoutes()
{
    // ╨Ü╤Ç╨░╤ü╨╕╨▓╨░╤Å ╤ü╤é╤Ç╨░╨╜╨╕╤å╨░ ╨┐╨╛╨║╨░╨╖╨░╨╜╨╕╨╣ ╤ü ╨╕╨║╨╛╨╜╨║╨░╨╝╨╕ (╨╛╤Ç╨╕╨│╨╕╨╜╨░╨╗╤î╨╜╤ï╨╣ ╨┤╨╕╨╖╨░╨╣╨╜)
    webServer.on(
        "/readings", HTTP_GET,
        []()
        {
            logWebRequest("GET", "/readings", webServer.client().remoteIP().toString());

            if (currentWiFiMode == WiFiMode::AP)
            {
                webServer.send(200, "text/html; charset=utf-8",
                               generateApModeUnavailablePage("╨ƒ╨╛╨║╨░╨╖╨░╨╜╨╕╤Å", UI_ICON_DATA));
                return;
            }

            String html = generatePageHeader("╨ƒ╨╛╨║╨░╨╖╨░╨╜╨╕╤Å ╨┤╨░╤é╤ç╨╕╨║╨░", UI_ICON_DATA);
            html += navHtml();
            html += "<h1>" UI_ICON_DATA " ╨ƒ╨╛╨║╨░╨╖╨░╨╜╨╕╤Å ╨┤╨░╤é╤ç╨╕╨║╨░</h1>";

            // ╨ÿ╨╜╤ä╨╛╤Ç╨╝╨░╤å╨╕╨╛╨╜╨╜╨░╤Å ╤ü╤é╤Ç╨╛╨║╨░ ╤ü╨╛╤ü╤é╨╛╤Å╨╜╨╕╤Å
            html += "<div id='statusInfo' style='margin:10px 0;font-size:16px;color:#333'></div>";

            // ======= ╨₧╨æ╨¬╨»╨í╨¥╨ò╨¥╨ÿ╨ò ╨ƒ╨á╨₧╨ª╨ò╨í╨í╨₧╨Æ =======
            html += "<div class='section' style='background:#f8f9fa;padding:15px;border-radius:8px;margin:15px 0;'>";
            html += "<h3>≡ƒôï ╨Ü╨░╨║ ╤Ç╨░╨▒╨╛╤é╨░╤Ä╤é ╨┐╨╛╨║╨░╨╖╨░╨╜╨╕╤Å</h3>";
            html += "<div style='display:grid;grid-template-columns:1fr 1fr;gap:20px;font-size:14px;'>";

            // ╨¢╨╡╨▓╨░╤Å ╨║╨╛╨╗╨╛╨╜╨║╨░ - ╨║╨╛╨╝╨┐╨╡╨╜╤ü╨░╤å╨╕╤Å
            html += "<div>";
            html += "<h4>≡ƒöº ╨Ü╨╛╨╝╨┐╨╡╨╜╤ü╨░╤å╨╕╤Å ╨┐╨╛╨║╨░╨╖╨░╨╜╨╕╨╣</h4>";
            html += "<ul style='margin:0;padding-left:20px;'>";
            html += "<li><strong>RAW</strong> - ╤ü╤ï╤Ç╤ï╨╡ ╨┤╨░╨╜╨╜╤ï╨╡ ╤ü ╨┤╨░╤é╤ç╨╕╨║╨░</li>";
            html += "<li><strong>╨Ü╨╛╨╝╨┐╨╡╨╜╤ü.</strong> - ╨┤╨░╨╜╨╜╤ï╨╡ ╨┐╨╛╤ü╨╗╨╡ ╨╝╨░╤é╨╡╨╝╨░╤é╨╕╤ç╨╡╤ü╨║╨╛╨╣ ╨║╨╛╨╝╨┐╨╡╨╜╤ü╨░╤å╨╕╨╕:</li>";
            html += "<ul style='margin:5px 0;padding-left:15px;'>";
            html += "<li>≡ƒîí∩╕Å <strong>╨ó╨╡╨╝╨┐╨╡╤Ç╨░╤é╤â╤Ç╨░:</strong> ╨▒╨╡╨╖ ╨╕╨╖╨╝╨╡╨╜╨╡╨╜╨╕╨╣</li>";
            html += "<li>≡ƒÆº <strong>╨Æ╨╗╨░╨╢╨╜╨╛╤ü╤é╤î:</strong> ╨▒╨╡╨╖ ╨╕╨╖╨╝╨╡╨╜╨╡╨╜╨╕╨╣</li>";
            html += "<li>ΓÜí <strong>EC:</strong> ╤é╨╡╨╝╨┐╨╡╤Ç╨░╤é╤â╤Ç╨╜╨░╤Å ╨║╨╛╨╝╨┐╨╡╨╜╤ü╨░╤å╨╕╤Å + ╨╝╨╛╨┤╨╡╨╗╤î ╨É╤Ç╤ç╨╕ (Archie, 1942)</li>";
            html += "<li>ΓÜù∩╕Å <strong>pH:</strong> ╤é╨╡╨╝╨┐╨╡╤Ç╨░╤é╤â╤Ç╨╜╨░╤Å ╨┐╨╛╨┐╤Ç╨░╨▓╨║╨░ ╨┐╨╛ ╨¥╨╡╤Ç╨╜╤ü╤é╤â (-0.003├ù╬öT)</li>";
            html +=
                "<li>≡ƒö┤≡ƒƒí≡ƒö╡ <strong>NPK:</strong> ╨║╨╛╤Ç╤Ç╨╡╨║╤å╨╕╤Å ╨┐╨╛ T, ╨▓╨╗╨░╨╢╨╜╨╛╤ü╤é╨╕ ╨╕ ╤é╨╕╨┐╤â ╨┐╨╛╤ç╨▓╤ï (Delgado et al., 2020) "
                "Sci.)</li>";
            html += "</ul>";
            html += "</ul>";
            html += "</div>";

            // ╨ƒ╤Ç╨░╨▓╨░╤Å ╨║╨╛╨╗╨╛╨╜╨║╨░ - ╤Ç╨╡╨║╨╛╨╝╨╡╨╜╨┤╨░╤å╨╕╨╕
            html += "<div>";
            html += "<h4>≡ƒÄ» ╨á╨╡╨║╨╛╨╝╨╡╨╜╨┤╨░╤å╨╕╨╕</h4>";
            html += "<ul style='margin:0;padding-left:20px;'>";
            html += "<li><strong>╨æ╨░╨╖╨╛╨▓╤ï╨╡ ╨╜╨╛╤Ç╨╝╤ï</strong> ╨┤╨╗╤Å ╨▓╤ï╨▒╤Ç╨░╨╜╨╜╨╛╨╣ ╨║╤â╨╗╤î╤é╤â╤Ç╤ï</li>";
            html += "<li><strong>╨í╨╡╨╖╨╛╨╜╨╜╤ï╨╡ ╨║╨╛╤Ç╤Ç╨╡╨║╤é╨╕╤Ç╨╛╨▓╨║╨╕</strong> (╨▓╨╡╤ü╨╜╨░/╨╗╨╡╤é╨╛/╨╛╤ü╨╡╨╜╤î/╨╖╨╕╨╝╨░)</li>";
            html += "<li><strong>╨ó╨╕╨┐ ╤ü╤Ç╨╡╨┤╤ï</strong> (╨╛╤é╨║╤Ç╤ï╤é╤ï╨╣ ╨│╤Ç╤â╨╜╤é/╤é╨╡╨┐╨╗╨╕╤å╨░/╨┐╨╛╨╝╨╡╤ë╨╡╨╜╨╕╨╡)</li>";
            html += "<li><strong>╨ª╨▓╨╡╤é╨╛╨▓╨░╤Å ╨╕╨╜╨┤╨╕╨║╨░╤å╨╕╤Å:</strong></li>";
            html += "<ul style='margin:5px 0;padding-left:15px;'>";
            html += "<li>≡ƒƒó <strong>╨ù╨╡╨╗╨╡╨╜╤ï╨╣:</strong> ╨╛╨┐╤é╨╕╨╝╨░╨╗╤î╨╜╤ï╨╡ ╤â╤ü╨╗╨╛╨▓╨╕╤Å ╨╕╨╖╨╝╨╡╤Ç╨╡╨╜╨╕╤Å</li>";
            html +=
                "<li>≡ƒƒá <strong>╨₧╤Ç╨░╨╜╨╢╨╡╨▓╤ï╨╣:</strong> ╨╜╨╡╨╛╨┐╤é╨╕╨╝╨░╨╗╤î╨╜╤ï╨╡ ╤â╤ü╨╗╨╛╨▓╨╕╤Å (╨▓╨╗╨░╨╢╨╜╨╛╤ü╤é╤î <25%, ╤é╨╡╨╝╨┐╨╡╤Ç╨░╤é╤â╤Ç╨░ <5┬░C ╨╕╨╗╨╕ "
                ">40┬░C)</li>";
            html += "<li>≡ƒö╡ <strong>╨í╨╕╨╜╨╕╨╣:</strong> ╨┐╨╛╨╗╨╕╨▓ ╨░╨║╤é╨╕╨▓╨╡╨╜ (╨▓╤Ç╨╡╨╝╨╡╨╜╨╜╨░╤Å ╨╜╨╡╨▓╨░╨╗╨╕╨┤╨╜╨╛╤ü╤é╤î)</li>";
            html += "<li>≡ƒö┤ <strong>╨Ü╤Ç╨░╤ü╨╜╤ï╨╣:</strong> ╨╛╤ê╨╕╨▒╨║╨╕ ╨┤╨░╤é╤ç╨╕╨║╨░ (╨▓╤ï╤à╨╛╨┤ ╨╖╨░ ╤ä╨╕╨╖╨╕╤ç╨╡╤ü╨║╨╕╨╡ ╨┐╤Ç╨╡╨┤╨╡╨╗╤ï)</li>";
            html += "</ul>";
            html += "</ul>";
            html += "</div>";

            html += "</div>";
            html += "</div>";

            // ╨ù╨░╨│╨╛╨╗╨╛╨▓╨╛╨║ 4-╨│╨╛ ╤ü╤é╨╛╨╗╨▒╤å╨░: ╨▓╤ï╨▒╤Ç╨░╨╜╨╜╨░╤Å ╨║╤â╨╗╤î╤é╤â╤Ç╨░ ╨╕╨╗╨╕ ┬½╨á╨╡╨║╨╛╨╝.┬╗
            String recHeader = "╨á╨╡╨║╨╛╨╝.";
            if (strlen(config.cropId) > 0)
            {
                const char* cropId = config.cropId;
                if (strcmp(cropId, "tomato") == 0)
                {
                    recHeader = "╨ó╨╛╨╝╨░╤é╤ï";
                }
                else if (strcmp(cropId, "cucumber") == 0)
                {
                    recHeader = "╨₧╨│╤â╤Ç╤å╤ï";
                }
                else if (strcmp(cropId, "pepper") == 0)
                {
                    recHeader = "╨ƒ╨╡╤Ç╨╡╤å";
                }
                else if (strcmp(cropId, "lettuce") == 0)
                {
                    recHeader = "╨í╨░╨╗╨░╤é";
                }
                else if (strcmp(cropId, "blueberry") == 0)
                {
                    recHeader = "╨ô╨╛╨╗╤â╨▒╨╕╨║╨░";
                }
                else if (strcmp(cropId, "lawn") == 0)
                {
                    recHeader = "╨ô╨░╨╖╨╛╨╜";
                }
                else if (strcmp(cropId, "grape") == 0)
                {
                    recHeader = "╨Æ╨╕╨╜╨╛╨│╤Ç╨░╨┤";
                }
                else if (strcmp(cropId, "conifer") == 0)
                {
                    recHeader = "╨Ñ╨▓╨╛╨╣╨╜╤ï╨╡";
                }
                else if (strcmp(cropId, "strawberry") == 0)
                {
                    recHeader = "╨Ü╨╗╤â╨▒╨╜╨╕╨║╨░";
                }
                else if (strcmp(cropId, "apple") == 0)
                {
                    recHeader = "╨»╨▒╨╗╨╛╨╜╤Å";
                }
                else if (strcmp(cropId, "pear") == 0)
                {
                    recHeader = "╨ô╤Ç╤â╤ê╨░";
                }
                else if (strcmp(cropId, "cherry") == 0)
                {
                    recHeader = "╨Æ╨╕╤ê╨╜╤Å";
                }
                else if (strcmp(cropId, "raspberry") == 0)
                {
                    recHeader = "╨£╨░╨╗╨╕╨╜╨░";
                }
                else if (strcmp(cropId, "currant") == 0)
                {
                    recHeader = "╨í╨╝╨╛╤Ç╨╛╨┤╨╕╨╜╨░";
                }
            }

            html += "<div class='section'><table class='data'><thead><tr><th></th><th>RAW</th><th>╨Ü╨╛╨╝╨┐╨╡╨╜╤ü.</th><th>" +
                    recHeader + "</th></tr></thead><tbody>";
            html +=
                "<tr><td>≡ƒîí∩╕Å ╨ó╨╡╨╝╨┐╨╡╤Ç╨░╤é╤â╤Ç╨░, ┬░C</td><td><span id='temp_raw'></span></td><td><span "
                "id='temp'></span></td><td><span id='temp_rec'></span></td></tr>";
            html +=
                "<tr><td>≡ƒÆº ╨Æ╨╗╨░╨╢╨╜╨╛╤ü╤é╤î, %</td><td><span id='hum_raw'></span></td><td><span "
                "id='hum'></span></td><td><span id='hum_rec'></span></td></tr>";
            html +=
                "<tr><td>ΓÜí EC, ┬╡S/cm</td><td><span id='ec_raw'></span></td><td><span id='ec'></span></td><td><span "
                "id='ec_rec'></span></td></tr>";
            html +=
                "<tr><td>ΓÜù∩╕Å pH</td><td><span id='ph_raw'></span></td><td><span id='ph'></span></td><td><span "
                "id='ph_rec'></span></td></tr>";
            html +=
                "<tr><td>≡ƒö┤ ╨É╨╖╨╛╤é (N), ╨╝╨│/╨║╨│</td><td><span id='n_raw'></span></td><td><span "
                "id='n'></span></td><td><span id='n_rec'></span><span id='n_season' "
                "class='season-adj'></span></td></tr>";
            html +=
                "<tr><td>≡ƒƒí ╨ñ╨╛╤ü╤ä╨╛╤Ç (P), ╨╝╨│/╨║╨│</td><td><span id='p_raw'></span></td><td><span "
                "id='p'></span></td><td><span id='p_rec'></span><span id='p_season' "
                "class='season-adj'></span></td></tr>";
            html +=
                "<tr><td>≡ƒö╡ ╨Ü╨░╨╗╨╕╨╣ (K), ╨╝╨│/╨║╨│</td><td><span id='k_raw'></span></td><td><span "
                "id='k'></span></td><td><span id='k_rec'></span><span id='k_season' "
                "class='season-adj'></span></td></tr>";
            html += "</tbody></table></div>";

            // ======= ╨Ü╨É╨¢╨ÿ╨æ╨á╨₧╨Æ╨Ü╨É =======
            html += "<div class='section'><h2>ΓÜÖ∩╕Å ╨Ü╨░╨╗╨╕╨▒╤Ç╨╛╨▓╨║╨░ ╨┤╨░╤é╤ç╨╕╨║╨░</h2>";

            // ╨í╤é╨░╤é╤â╤ü ╨║╨░╨╗╨╕╨▒╤Ç╨╛╨▓╨║╨╕
            html += "<div style='background:#f8f9fa;padding:15px;border-radius:8px;margin:15px 0;'>";
            html += "<h4>≡ƒôè ╨ó╨╡╨║╤â╤ë╨╕╨╣ ╤ü╤é╨░╤é╤â╤ü ╨║╨░╨╗╨╕╨▒╤Ç╨╛╨▓╨║╨╕</h4>";
            html += "<div id='calibration-status'>╨ù╨░╨│╤Ç╤â╨╖╨║╨░ ╤ü╤é╨░╤é╤â╤ü╨░...</div>";
            html += "</div>";

            // ╨ó╨╡╨╝╨┐╨╡╤Ç╨░╤é╤â╤Ç╨░ ╨║╨░╨╗╨╕╨▒╤Ç╨╛╨▓╨║╨░ (╨┐╤Ç╨╛╤ü╤é╨╛╨╡ ╤ü╨╝╨╡╤ë╨╡╨╜╨╕╨╡)
            html += "<div class='section'>";
            html += "<h3>≡ƒîí∩╕Å ╨ó╨╡╨╝╨┐╨╡╤Ç╨░╤é╤â╤Ç╨░ ╨║╨░╨╗╨╕╨▒╤Ç╨╛╨▓╨║╨░</h3>";
            html += "<p>╨Ü╨╛╤Ç╤Ç╨╡╨║╤å╨╕╤Å ╤ü╨╝╨╡╤ë╨╡╨╜╨╕╤Å (offset): <span id='temp_offset'>0.0</span>┬░C</p>";
            html += "<div class='form-group'>";
            html += "<label>╨æ╤ï╤ü╤é╤Ç╨░╤Å ╨╜╨░╤ü╤é╤Ç╨╛╨╣╨║╨░:</label>";
            html += "<div style='display:flex;gap:10px;align-items:center;'>";
            html += "<button onclick='adjustTempOffset(-0.1)' class='btn btn-sm btn-outline-secondary'>-0.1</button>";
            html += "<button onclick='adjustTempOffset(-0.5)' class='btn btn-sm btn-outline-secondary'>-0.5</button>";
            html += "<button onclick='adjustTempOffset(-1.0)' class='btn btn-sm btn-outline-secondary'>-1.0</button>";
            html += "<span style='font-weight:bold;margin:0 10px;'>╨ó╨╡╨║╤â╤ë╨╕╨╣ offset</span>";
            html += "<button onclick='adjustTempOffset(1.0)' class='btn btn-sm btn-outline-secondary'>+1.0</button>";
            html += "<button onclick='adjustTempOffset(0.5)' class='btn btn-sm btn-outline-secondary'>+0.5</button>";
            html += "<button onclick='adjustTempOffset(0.1)' class='btn btn-sm btn-outline-secondary'>+0.1</button>";
            html += "</div>";
            html += "</div>";
            html += "<div class='form-group'>";
            html += "<label for='temp_offset_input'>╨ó╨╛╤ç╨╜╨╛╨╡ ╨╖╨╜╨░╤ç╨╡╨╜╨╕╨╡ offset (┬░C):</label>";
            html += "<input type='number' id='temp_offset_input' step='0.1' min='-10' max='10' placeholder='0.0' onchange='setTempOffset(this.value)'>";
            html += "</div>";
            html += "<button onclick='saveTempOffset()' class='btn btn-primary'>╨í╨╛╤à╤Ç╨░╨╜╨╕╤é╤î ╨║╨╛╤Ç╤Ç╨╡╨║╤å╨╕╤Ä</button>";
            html += "</div>";

            // ╨Æ╨╗╨░╨╢╨╜╨╛╤ü╤é╤î ╨║╨░╨╗╨╕╨▒╤Ç╨╛╨▓╨║╨░ (╨┐╤Ç╨╛╤ü╤é╨╛╨╡ ╤ü╨╝╨╡╤ë╨╡╨╜╨╕╨╡)
            html += "<div class='section'>";
            html += "<h3>≡ƒÆº ╨Æ╨╗╨░╨╢╨╜╨╛╤ü╤é╤î ╨║╨░╨╗╨╕╨▒╤Ç╨╛╨▓╨║╨░</h3>";
            html += "<p>╨Ü╨╛╤Ç╤Ç╨╡╨║╤å╨╕╤Å ╤ü╨╝╨╡╤ë╨╡╨╜╨╕╤Å (offset): <span id='hum_offset'>0.0</span>%</p>";
            html += "<div class='form-group'>";
            html += "<label>╨æ╤ï╤ü╤é╤Ç╨░╤Å ╨╜╨░╤ü╤é╤Ç╨╛╨╣╨║╨░:</label>";
            html += "<div style='display:flex;gap:10px;align-items:center;'>";
            html += "<button onclick='adjustHumOffset(-1.0)' class='btn btn-sm btn-outline-secondary'>-1.0</button>";
            html += "<button onclick='adjustHumOffset(-0.5)' class='btn btn-sm btn-outline-secondary'>-0.5</button>";
            html += "<button onclick='adjustHumOffset(-0.1)' class='btn btn-sm btn-outline-secondary'>-0.1</button>";
            html += "<span style='font-weight:bold;margin:0 10px;'>╨ó╨╡╨║╤â╤ë╨╕╨╣ offset</span>";
            html += "<button onclick='adjustHumOffset(0.1)' class='btn btn-sm btn-outline-secondary'>+0.1</button>";
            html += "<button onclick='adjustHumOffset(0.5)' class='btn btn-sm btn-outline-secondary'>+0.5</button>";
            html += "<button onclick='adjustHumOffset(1.0)' class='btn btn-sm btn-outline-secondary'>+1.0</button>";
            html += "</div>";
            html += "</div>";
            html += "<div class='form-group'>";
            html += "<label for='hum_offset_input'>╨ó╨╛╤ç╨╜╨╛╨╡ ╨╖╨╜╨░╤ç╨╡╨╜╨╕╨╡ offset (%):</label>";
            html += "<input type='number' id='hum_offset_input' step='0.1' min='-10' max='10' placeholder='0.0' onchange='setHumOffset(this.value)'>";
            html += "</div>";
            html += "<button onclick='saveHumOffset()' class='btn btn-primary'>╨í╨╛╤à╤Ç╨░╨╜╨╕╤é╤î ╨║╨╛╤Ç╤Ç╨╡╨║╤å╨╕╤Ä</button>";
            html += "</div>";

            // pH ╨║╨░╨╗╨╕╨▒╤Ç╨╛╨▓╨║╨░
            html += "<div class='section'>";
            html += "<h3>≡ƒº¬ pH ╨║╨░╨╗╨╕╨▒╤Ç╨╛╨▓╨║╨░</h3>";
            html += "<p>╨Æ╨▓╨╡╨┤╨╕╤é╨╡ ╨┐╨╛╨║╨░╨╖╨░╨╜╨╕╤Å ╨┤╨╗╤Å ╨▒╤â╤ä╨╡╤Ç╨╜╤ï╤à ╤Ç╨░╤ü╤é╨▓╨╛╤Ç╨╛╨▓ pH:</p>";
            html += "<div class='form-group'>";
            html += "<label for='ph_expected'>╨₧╨╢╨╕╨┤╨░╨╡╨╝╨╛╨╡ ╨╖╨╜╨░╤ç╨╡╨╜╨╕╨╡ pH:</label>";
            html += "<input type='number' id='ph_expected' step='0.1' min='0' max='14' placeholder='7.0'>";
            html += "</div>";
            html += "<div class='form-group'>";
            html += "<label for='ph_measured'>╨ÿ╨╖╨╝╨╡╤Ç╨╡╨╜╨╜╨╛╨╡ ╨╖╨╜╨░╤ç╨╡╨╜╨╕╨╡ pH:</label>";
            html += "<input type='number' id='ph_measured' step='0.1' min='0' max='14' placeholder='6.8'>";
            html += "</div>";
            html += "<button onclick='addPHPoint()' class='btn btn-primary'>╨ö╨╛╨▒╨░╨▓╨╕╤é╤î ╤é╨╛╤ç╨║╤â pH</button>";
            html += "<div id='ph-points' style='margin-top:10px;'></div>";
            html += "</div>";

            // EC ╨║╨░╨╗╨╕╨▒╤Ç╨╛╨▓╨║╨░
            html += "<div class='section'>";
            html += "<h3>ΓÜí EC ╨║╨░╨╗╨╕╨▒╤Ç╨╛╨▓╨║╨░</h3>";
            html += "<p>╨Æ╨▓╨╡╨┤╨╕╤é╨╡ ╨┐╨╛╨║╨░╨╖╨░╨╜╨╕╤Å ╨┤╨╗╤Å ╤ü╤é╨░╨╜╨┤╨░╤Ç╤é╨╜╤ï╤à ╤Ç╨░╤ü╤é╨▓╨╛╤Ç╨╛╨▓ EC:</p>";
            html += "<div class='form-group'>";
            html += "<label for='ec_expected'>╨₧╨╢╨╕╨┤╨░╨╡╨╝╨╛╨╡ ╨╖╨╜╨░╤ç╨╡╨╜╨╕╨╡ EC (╨╝╨í╨╝/╤ü╨╝):</label>";
            html += "<input type='number' id='ec_expected' step='0.1' min='0' placeholder='1.0'>";
            html += "</div>";
            html += "<div class='form-group'>";
            html += "<label for='ec_measured'>╨ÿ╨╖╨╝╨╡╤Ç╨╡╨╜╨╜╨╛╨╡ ╨╖╨╜╨░╤ç╨╡╨╜╨╕╨╡ EC (╨╝╨í╨╝/╤ü╨╝):</label>";
            html += "<input type='number' id='ec_measured' step='0.1' min='0' placeholder='0.95'>";
            html += "</div>";
            html += "<button onclick='addECPoint()' class='btn btn-primary'>╨ö╨╛╨▒╨░╨▓╨╕╤é╤î ╤é╨╛╤ç╨║╤â EC</button>";
            html += "<div id='ec-points' style='margin-top:10px;'></div>";
            html += "</div>";

            // NPK ╨║╨░╨╗╨╕╨▒╤Ç╨╛╨▓╨║╨░ (╨╗╨╕╨╜╨╡╨╣╨╜╨░╤Å ╨║╨╛╤Ç╤Ç╨╡╨║╤å╨╕╤Å)
            html += "<div class='section'>";
            html += "<h3>≡ƒî▒ NPK ╨║╨░╨╗╨╕╨▒╤Ç╨╛╨▓╨║╨░</h3>";
            html += "<p>╨¢╨╕╨╜╨╡╨╣╨╜╨░╤Å ╨║╨╛╤Ç╤Ç╨╡╨║╤å╨╕╤Å: <strong>corrected = slope ├ù raw + offset</strong></p>";
            html += "<div class='form-group'>";
            html += "<label for='npk_n_raw'>N - ╤ü╤ï╤Ç╨╛╨╡ ╨╖╨╜╨░╤ç╨╡╨╜╨╕╨╡ (╨╝╨│/╨║╨│):</label>";
            html += "<input type='number' id='npk_n_raw' step='0.1' min='0' placeholder='0.0'>";
            html += "</div>";
            html += "<div class='form-group'>";
            html += "<label for='npk_n_reference'>N - ╤ì╤é╨░╨╗╨╛╨╜╨╜╨╛╨╡ ╨╖╨╜╨░╤ç╨╡╨╜╨╕╨╡ (╨╝╨│/╨║╨│):</label>";
            html += "<input type='number' id='npk_n_reference' step='0.1' min='0' placeholder='0.0'>";
            html += "</div>";
            html += "<div class='form-group'>";
            html += "<label for='npk_p_raw'>P - ╤ü╤ï╤Ç╨╛╨╡ ╨╖╨╜╨░╤ç╨╡╨╜╨╕╨╡ (╨╝╨│/╨║╨│):</label>";
            html += "<input type='number' id='npk_p_raw' step='0.1' min='0' placeholder='0.0'>";
            html += "</div>";
            html += "<div class='form-group'>";
            html += "<label for='npk_p_reference'>P - ╤ì╤é╨░╨╗╨╛╨╜╨╜╨╛╨╡ ╨╖╨╜╨░╤ç╨╡╨╜╨╕╨╡ (╨╝╨│/╨║╨│):</label>";
            html += "<input type='number' id='npk_p_reference' step='0.1' min='0' placeholder='0.0'>";
            html += "</div>";
            html += "<div class='form-group'>";
            html += "<label for='npk_k_raw'>K - ╤ü╤ï╤Ç╨╛╨╡ ╨╖╨╜╨░╤ç╨╡╨╜╨╕╨╡ (╨╝╨│/╨║╨│):</label>";
            html += "<input type='number' id='npk_k_raw' step='0.1' min='0' placeholder='0.0'>";
            html += "</div>";
            html += "<div class='form-group'>";
            html += "<label for='npk_k_reference'>K - ╤ì╤é╨░╨╗╨╛╨╜╨╜╨╛╨╡ ╨╖╨╜╨░╤ç╨╡╨╜╨╕╨╡ (╨╝╨│/╨║╨│):</label>";
            html += "<input type='number' id='npk_k_reference' step='0.1' min='0' placeholder='0.0'>";
            html += "</div>";
            html += "<button onclick='calculateNPKCalibration()' class='btn btn-primary'>╨á╨░╤ü╤ü╤ç╨╕╤é╨░╤é╤î NPK ╨║╨╛╤Ç╤Ç╨╡╨║╤å╨╕╤Ä</button>";
            html += "<div id='npk-coefficients' style='margin-top:10px;background:#f8f9fa;padding:10px;border-radius:5px;display:none;'>";
            html += "<h4>╨Ü╨╛╤ì╤ä╤ä╨╕╤å╨╕╨╡╨╜╤é╤ï ╨║╨╛╤Ç╤Ç╨╡╨║╤å╨╕╨╕:</h4>";
            html += "<p>N: slope = <span id='npk_n_slope'>1.0</span>, offset = <span id='npk_n_offset'>0.0</span></p>";
            html += "<p>P: slope = <span id='npk_p_slope'>1.0</span>, offset = <span id='npk_p_offset'>0.0</span></p>";
            html += "<p>K: slope = <span id='npk_k_slope'>1.0</span>, offset = <span id='npk_k_offset'>0.0</span></p>";
            html += "</div>";
            html += "</div>";

            // ╨ö╨╡╨╣╤ü╤é╨▓╨╕╤Å
            html += "<div class='section'>";
            html += "<h3>ΓÜÖ∩╕Å ╨ö╨╡╨╣╤ü╤é╨▓╨╕╤Å</h3>";
            html += "<div style='display:grid;grid-template-columns:1fr 1fr;gap:10px;margin-bottom:10px;'>";
            html += "<button onclick='calculatePH()' class='btn btn-success'>╨á╨░╤ü╤ü╤ç╨╕╤é╨░╤é╤î pH</button>";
            html += "<button onclick='calculateEC()' class='btn btn-success'>╨á╨░╤ü╤ü╤ç╨╕╤é╨░╤é╤î EC</button>";
            html += "</div>";
            html += "<div style='display:grid;grid-template-columns:1fr 1fr;gap:10px;margin-bottom:10px;'>";
            html += "<button onclick='exportCalibration()' class='btn btn-info'>╨¡╨║╤ü╨┐╨╛╤Ç╤é</button>";
            html += "<button onclick='importCalibration()' class='btn btn-info'>╨ÿ╨╝╨┐╨╛╤Ç╤é</button>";
            html += "</div>";
            html += "<button onclick='resetCalibration()' class='btn btn-danger'>╨í╨▒╤Ç╨╛╤ü╨╕╤é╤î ╨║╨░╨╗╨╕╨▒╤Ç╨╛╨▓╨║╤â</button>";
            html += "</div>";

            // ======= ╨ö╨₧╨ƒ╨₧╨¢╨¥╨ÿ╨ó╨ò╨¢╨¼╨¥╨É╨» ╨ÿ╨¥╨ñ╨₧╨á╨£╨É╨ª╨ÿ╨» =======
            html += "<div class='section' style='background:#e8f5e8;padding:15px;border-radius:8px;margin:15px 0;'>";
            html += "<h4>≡ƒÆí ╨ƒ╨╛╨╗╨╡╨╖╨╜╨░╤Å ╨╕╨╜╤ä╨╛╤Ç╨╝╨░╤å╨╕╤Å</h4>";
            html += "<ul style='margin:5px 0;padding-left:20px;font-size:14px;'>";
            html += "<li><strong>╨í╤é╤Ç╨╡╨╗╨║╨╕ ΓåæΓåô</strong> ╨┐╨╛╨║╨░╨╖╤ï╨▓╨░╤Ä╤é ╨╜╨░╨┐╤Ç╨░╨▓╨╗╨╡╨╜╨╕╨╡ ╨╕╨╖╨╝╨╡╨╜╨╡╨╜╨╕╨╣ ╨┐╨╛╤ü╨╗╨╡ ╨║╨╛╨╝╨┐╨╡╨╜╤ü╨░╤å╨╕╨╕</li>";
            html += "<li><strong>╨í╨╡╨╖╨╛╨╜╨╜╤ï╨╡ ╨║╨╛╤Ç╤Ç╨╡╨║╤é╨╕╤Ç╨╛╨▓╨║╨╕</strong> ╤â╤ç╨╕╤é╤ï╨▓╨░╤Ä╤é ╨┐╨╛╤é╤Ç╨╡╨▒╨╜╨╛╤ü╤é╨╕ ╤Ç╨░╤ü╤é╨╡╨╜╨╕╨╣ ╨▓ ╤Ç╨░╨╖╨╜╤ï╨╡ ╨┐╨╡╤Ç╨╕╨╛╨┤╤ï</li>";
            html += "<li><strong>╨Æ╨░╨╗╨╕╨┤╨╜╨╛╤ü╤é╤î ╨┤╨░╨╜╨╜╤ï╤à</strong> ╨┐╤Ç╨╛╨▓╨╡╤Ç╤Å╨╡╤é╤ü╤Å ╨┐╨╛ ╨┤╨╕╨░╨┐╨░╨╖╨╛╨╜╨░╨╝ ╨╕ ╨╗╨╛╨│╨╕╤ç╨╡╤ü╨║╨╕╨╝ ╤ü╨▓╤Å╨╖╤Å╨╝</li>";
            html += "<li><strong>╨ÿ╨╜╤é╨╡╤Ç╨▓╨░╨╗ ╨╛╨▒╨╜╨╛╨▓╨╗╨╡╨╜╨╕╤Å:</strong> ╨║╨░╨╢╨┤╤ï╨╡ 3 ╤ü╨╡╨║╤â╨╜╨┤╤ï</li>";
            html += "</ul>";
            html += "</div>";

            html += "<style>";
            html += ".season-adj { font-size: 0.8em; margin-left: 5px; }";
            html += ".season-adj.up { color: #2ecc71; }";
            html += ".season-adj.down { color: #e74c3c; }";
            html +=
                ".data{width:100%;border-collapse:collapse}.data th,.data td{border:1px solid "
                "#ccc;padding:6px;text-align:center}.data "
                "th{background:#f5f5f5}.green{color:#4CAF50}.yellow{color:#FFC107}.orange{color:#FF9800}.red{color:#"
                "F44336}.blue{color:#2196F3}";
            html += "</style>";

            html += "<script>";
            html += "function set(id,v){if(v!==undefined&&v!==null){document.getElementById(id).textContent=v;}}";
            html +=
                "function colorDelta(a,b){var diff=Math.abs(a-b)/b*100;if(diff>30)return 'red';if(diff>20)return "
                "'orange';if(diff>10)return 'yellow';return '';}";
            html +=
                "function colorRange(v,min,max){var span=(max-min);if(span<=0)return '';if(v<min||v>max)return "
                "'red';if(v<min+0.05*span||v>max-0.05*span)return 'orange';if(v<min+0.10*span||v>max-0.10*span)return "
                "'yellow';return '';}";
            html +=
                "function applyColor(spanId,cls){var "
                "el=document.getElementById(spanId);if(!el)return;el.classList.remove('red','orange','yellow','green');"
                "if(cls){el.classList.add(cls);}else{el.classList.add('green');}}";
            html +=
                "var "
                "limits={temp:{min:-45,max:115},hum:{min:0,max:100},ec:{min:0,max:10000},ph:{min:3,max:9},n:{min:0,max:"
                "1999},p:{min:0,max:1999},k:{min:0,max:1999}};";
            html += "function updateSensor(){";
            html += "fetch('/sensor_json').then(r=>r.json()).then(d=>{";
            html += "set('temp_raw',d.raw_temperature);";
            html += "set('hum_raw',d.raw_humidity);";
            html += "set('ec_raw',d.raw_ec);";
            html += "set('ph_raw',d.raw_ph);";
            html += "set('n_raw',d.raw_nitrogen);";
            html += "set('p_raw',d.raw_phosphorus);";
            html += "set('k_raw',d.raw_potassium);";
            html +=
                "set('temp_rec',d.rec_temperature);set('hum_rec',d.rec_humidity);set('ec_rec',d.rec_ec);set('ph_rec',d."
                "rec_ph);set('n_rec',d.rec_nitrogen);set('p_rec',d.rec_phosphorus);set('k_rec',d.rec_potassium);";
            // === Arrow indicators block ===
            html += "const tol={temp:0.2,hum:0.5,ec:20,ph:0.05,n:5,p:3,k:3};";
            html +=
                "function "
                "arrowSign(base,val,thr){base=parseFloat(base);val=parseFloat(val);if(isNaN(base)||isNaN(val))return "
                "'';if(val>base+thr)return 'Γåæ ';if(val<base-thr)return 'Γåô ';return '';};";
            html += "function showWithArrow(id,sign,value){document.getElementById(id).textContent=sign+value;}";

            // Compensated vs RAW arrows
            html += "showWithArrow('temp', arrowSign(d.raw_temperature ,d.temperature ,tol.temp), d.temperature);";
            html += "showWithArrow('hum',  arrowSign(d.raw_humidity    ,d.humidity    ,tol.hum ), d.humidity);";
            html += "showWithArrow('ec',   arrowSign(d.raw_ec          ,d.ec          ,tol.ec  ), d.ec);";
            html += "showWithArrow('ph',   arrowSign(d.raw_ph          ,d.ph          ,tol.ph  ), d.ph);";
            html += "showWithArrow('n',    arrowSign(d.raw_nitrogen    ,d.nitrogen    ,tol.n   ), d.nitrogen);";
            html += "showWithArrow('p',    arrowSign(d.raw_phosphorus  ,d.phosphorus  ,tol.p   ), d.phosphorus);";
            html += "showWithArrow('k',    arrowSign(d.raw_potassium   ,d.potassium   ,tol.k   ), d.potassium);";

            // Recommendation arrows (target vs current)
            html +=
                "showWithArrow('temp_rec', arrowSign(d.temperature ,d.rec_temperature ,tol.temp), d.rec_temperature);";
            html += "showWithArrow('hum_rec',  arrowSign(d.humidity    ,d.rec_humidity    ,tol.hum ), d.rec_humidity);";
            html += "showWithArrow('ec_rec',   arrowSign(d.ec          ,d.rec_ec          ,tol.ec  ), d.rec_ec);";
            html += "showWithArrow('ph_rec',   arrowSign(d.ph          ,d.rec_ph          ,tol.ph  ), d.rec_ph);";
            html += "showWithArrow('n_rec',    arrowSign(d.nitrogen    ,d.rec_nitrogen    ,tol.n   ), d.rec_nitrogen);";
            html +=
                "showWithArrow('p_rec',    arrowSign(d.phosphorus  ,d.rec_phosphorus  ,tol.p   ), d.rec_phosphorus);";
            html +=
                "showWithArrow('k_rec',    arrowSign(d.potassium   ,d.rec_potassium   ,tol.k   ), d.rec_potassium);";
            // === End arrow indicators ===

            // ╨ö╨╛╨▒╨░╨▓╨╗╤Å╨╡╨╝ ╨╕╨╜╨┤╨╕╨║╨░╤å╨╕╤Ä ╤ü╨╡╨╖╨╛╨╜╨╜╤ï╤à ╨║╨╛╤Ç╤Ç╨╡╨║╤é╨╕╤Ç╨╛╨▓╨╛╨║
            html += "function updateSeasonalAdjustments(season) {";
            html += "  const adjustments = {";
            html += "    '╨Æ╨╡╤ü╨╜╨░': { n: '+20%', p: '+15%', k: '+10%' },";
            html += "    '╨¢╨╡╤é╨╛': { n: '-10%', p: '+5%', k: '+25%' },";
            html += "    '╨₧╤ü╨╡╨╜╤î': { n: '-20%', p: '+10%', k: '+15%' },";
            html += "    '╨ù╨╕╨╝╨░': { n: '-30%', p: '+5%', k: '+5%' }";
            html += "  };";
            html += "  const envType = " + String(config.environmentType) + ";";
            html += "  const adj = adjustments[season] || { n: '', p: '', k: '' };";
            html += "  ['n', 'p', 'k'].forEach(elem => {";
            html += "    const span = document.getElementById(elem + '_season');";
            html += "    if(span) {";
            html += "      span.textContent = adj[elem] ? ` (${adj[elem]})` : '';";
            html += "      span.className = 'season-adj ' + (adj[elem].startsWith('+') ? 'up' : 'down');";
            html += "    }";
            html += "  });";
            html += "}";

            html += R"(var invalid = d.irrigation || d.alerts.length>0 || d.humidity<25 || d.temperature<5 || )"
                    R"(d.temperature>40;)";
            html += R"(var statusHtml = invalid ? '<span class="red">╨ö╨░╨╜╨╜╤ï╨╡&nbsp;╨╜╨╡&nbsp;╨▓╨░╨╗╨╕╨┤╨╜╤ï</span>' : '<span )"
                    R"(class="green">╨ö╨░╨╜╨╜╤ï╨╡&nbsp;╨▓╨░╨╗╨╕╨┤╨╜╤ï</span>';)";
            html +=
                R"(var seasonColor={'╨¢╨╡╤é╨╛':'green','╨Æ╨╡╤ü╨╜╨░':'yellow','╨₧╤ü╨╡╨╜╤î':'yellow','╨ù╨╕╨╝╨░':'red','╨¥/╨ö':''}[d.season]||'';)";
            html += R"(var seasonHtml=seasonColor?(`<span class=\"${seasonColor}\">${d.season}</span>`):d.season;)";
            html += "document.getElementById('statusInfo').innerHTML=statusHtml+' | ╨í╨╡╨╖╨╛╨╜: '+seasonHtml;";
            html += "updateSeasonalAdjustments(d.season);";
            html +=
                "var "
                "tvr=parseFloat(d.raw_temperature);applyColor('temp_raw',colorRange(tvr,limits.temp.min,limits.temp."
                "max));";
            html +=
                "var "
                "hvr=parseFloat(d.raw_humidity);applyColor('hum_raw',colorRange(hvr,limits.hum.min,limits.hum.max));";
            html += "var evr=parseFloat(d.raw_ec);applyColor('ec_raw',colorRange(evr,limits.ec.min,limits.ec.max));";
            html += "var pvr=parseFloat(d.raw_ph);applyColor('ph_raw',colorRange(pvr,limits.ph.min,limits.ph.max));";
            html += "var nvr=parseFloat(d.raw_nitrogen);applyColor('n_raw',colorRange(nvr,limits.n.min,limits.n.max));";
            html +=
                "var p2r=parseFloat(d.raw_phosphorus);applyColor('p_raw',colorRange(p2r,limits.p.min,limits.p.max));";
            html +=
                "var kvr=parseFloat(d.raw_potassium);applyColor('k_raw',colorRange(kvr,limits.k.min,limits.k.max));";
            html +=
                "['temp','hum','ec','ph','n','p','k'].forEach(function(id){var "
                "el=document.getElementById(id);if(el){el.classList.remove('red','orange','yellow','green');}});";
            html += "var ct=parseFloat(d.temperature);";
            html += "var ch=parseFloat(d.humidity);";
            html += "var ce=parseFloat(d.ec);";
            html += "var cph=parseFloat(d.ph);";
            html += "var cn=parseFloat(d.nitrogen);";
            html += "var cp=parseFloat(d.phosphorus);";
            html += "var ck=parseFloat(d.potassium);";
            html += "applyColor('temp_rec', colorDelta(ct, parseFloat(d.rec_temperature)));";
            html += "applyColor('hum_rec',  colorDelta(ch, parseFloat(d.rec_humidity)));";
            html += "applyColor('ec_rec',   colorDelta(ce, parseFloat(d.rec_ec)));";
            html += "applyColor('ph_rec',   colorDelta(cph,parseFloat(d.rec_ph)));";
            html += "applyColor('n_rec',    colorDelta(cn, parseFloat(d.rec_nitrogen)));";
            html += "applyColor('p_rec',    colorDelta(cp, parseFloat(d.rec_phosphorus)));";
            html += "applyColor('k_rec',    colorDelta(ck, parseFloat(d.rec_potassium)));";
            html += "});";
            html += "}";

            // ╨ñ╤â╨╜╨║╤å╨╕╨╕ ╨║╨░╨╗╨╕╨▒╤Ç╨╛╨▓╨║╨╕
            html += "function updateCalibrationStatus() {";
            html += "  fetch('/api/calibration/status')";
            html += "    .then(response => response.json())";
            html += "    .then(data => {";
            html += "      let statusHtml = '<h4>≡ƒôè ╨í╤é╨░╤é╤â╤ü ╨║╨░╨╗╨╕╨▒╤Ç╨╛╨▓╨║╨╕</h4>';";
            html += "      for (let profile in data) {";
            html += "        const profileData = data[profile];";
            html += "        statusHtml += '<div class=\"profile-status\">';";
            html += "        statusHtml += '<strong>╨ƒ╤Ç╨╛╤ä╨╕╨╗╤î ' + profile + ':</strong> ';";
            html += "        statusHtml += profileData.is_complete ? 'Γ£à ╨ƒ╨╛╨╗╨╜╨░╤Å' : 'Γ¥î ╨¥╨╡╨┐╨╛╨╗╨╜╨░╤Å';";
            html += "        statusHtml += '<br>╨ö╨░╤é╤ç╨╕╨║╨╕: ';";
            html += "        profileData.sensors.forEach(sensor => {";
            html += "          statusHtml += sensor.is_valid ? 'Γ£à' : 'Γ¥î';";
            html += "          statusHtml += sensor.type_name + ' (' + sensor.point_count + ' ╤é╨╛╤ç╨╡╨║) ';";
            html += "        });";
            html += "        statusHtml += '</div>';";
            html += "      }";
            html += "      const statusElement = document.getElementById('calibration-status');";
            html += "      if (statusElement) {";
            html += "        statusElement.innerHTML = statusHtml;";
            html += "      }";
            html += "    })";
            html += "    .catch(error => {";
            html += "      console.error('Error updating calibration status:', error);";
            html += "      const statusElement = document.getElementById('calibration-status');";
            html += "      if (statusElement) {";
            html += "        statusElement.innerHTML = 'Γ¥î ╨₧╤ê╨╕╨▒╨║╨░ ╨╖╨░╨│╤Ç╤â╨╖╨║╨╕ ╤ü╤é╨░╤é╤â╤ü╨░';";
            html += "      }";
            html += "    });";
            html += "}";
            html += "function addPHPoint() {";
            html += "  const expected = parseFloat(document.getElementById('ph_expected').value);";
            html += "  const measured = parseFloat(document.getElementById('ph_measured').value);";
            html += "  fetch('/api/calibration/ph/add', {";
            html += "    method: 'POST',";
            html += "    headers: {'Content-Type': 'application/json'},";
            html += "    body: JSON.stringify({expected: expected, measured: measured})";
            html += "  }).then(response => response.json())";
            html += "    .then(data => {";
            html += "      if(data.success) {";
            html += "        updateCalibrationStatus();";
            html += "        document.getElementById('ph_expected').value = '';";
            html += "        document.getElementById('ph_measured').value = '';";
            html += "      }";
            html += "    });";
            html += "}";
            html += "function addECPoint() {";
            html += "  const expected = parseFloat(document.getElementById('ec_expected').value);";
            html += "  const measured = parseFloat(document.getElementById('ec_measured').value);";
            html += "  fetch('/api/calibration/ec/add', {";
            html += "    method: 'POST',";
            html += "    headers: {'Content-Type': 'application/json'},";
            html += "    body: JSON.stringify({expected: expected, measured: measured})";
            html += "  }).then(response => response.json())";
            html += "    .then(data => {";
            html += "      if(data.success) {";
            html += "        updateCalibrationStatus();";
            html += "        document.getElementById('ec_expected').value = '';";
            html += "        document.getElementById('ec_measured').value = '';";
            html += "      }";
                html += "    });";
    html += "}";
    html += "let tempOffset = 0.0;";
    html += "let humOffset = 0.0;";
    html += "";
    html += "function adjustTempOffset(delta) {";
    html += "  tempOffset += delta;";
    html += "  tempOffset = Math.round(tempOffset * 10) / 10;";
    html += "  document.getElementById('temp_offset').textContent = tempOffset.toFixed(1);";
    html += "  document.getElementById('temp_offset_input').value = tempOffset.toFixed(1);";
    html += "}";
    html += "";
    html += "function setTempOffset(value) {";
    html += "  tempOffset = parseFloat(value) || 0.0;";
    html += "  document.getElementById('temp_offset').textContent = tempOffset.toFixed(1);";
    html += "}";
    html += "";
    html += "function saveTempOffset() {";
    html += "  fetch('/api/calibration/temp/offset', {";
    html += "    method: 'POST',";
    html += "    headers: {'Content-Type': 'application/json'},";
    html += "    body: JSON.stringify({offset: tempOffset})";
    html += "  }).then(response => response.json())";
    html += "    .then(data => {";
    html += "      if(data.success) {";
    html += "        alert('╨Ü╨╛╤Ç╤Ç╨╡╨║╤å╨╕╤Å ╤é╨╡╨╝╨┐╨╡╤Ç╨░╤é╤â╤Ç╤ï ╤ü╨╛╤à╤Ç╨░╨╜╨╡╨╜╨░: ' + tempOffset.toFixed(1) + '┬░C');";
    html += "        updateCalibrationStatus();";
    html += "      }";
    html += "    });";
    html += "}";
    html += "";
    html += "function adjustHumOffset(delta) {";
    html += "  humOffset += delta;";
    html += "  humOffset = Math.round(humOffset * 10) / 10;";
    html += "  document.getElementById('hum_offset').textContent = humOffset.toFixed(1);";
    html += "  document.getElementById('hum_offset_input').value = humOffset.toFixed(1);";
    html += "}";
    html += "";
    html += "function setHumOffset(value) {";
    html += "  humOffset = parseFloat(value) || 0.0;";
    html += "  document.getElementById('hum_offset').textContent = humOffset.toFixed(1);";
    html += "}";
    html += "";
    html += "function saveHumOffset() {";
    html += "  fetch('/api/calibration/hum/offset', {";
    html += "    method: 'POST',";
    html += "    headers: {'Content-Type': 'application/json'},";
    html += "    body: JSON.stringify({offset: humOffset})";
    html += "  }).then(response => response.json())";
    html += "    .then(data => {";
    html += "      if(data.success) {";
    html += "        alert('╨Ü╨╛╤Ç╤Ç╨╡╨║╤å╨╕╤Å ╨▓╨╗╨░╨╢╨╜╨╛╤ü╤é╨╕ ╤ü╨╛╤à╤Ç╨░╨╜╨╡╨╜╨░: ' + humOffset.toFixed(1) + '%');";
    html += "        updateCalibrationStatus();";
    html += "      }";
    html += "    });";
    html += "}";
    html += "";
    html += "function calculateNPKCalibration() {";
    html += "  const nRaw = parseFloat(document.getElementById('npk_n_raw').value);";
    html += "  const nRef = parseFloat(document.getElementById('npk_n_reference').value);";
    html += "  const pRaw = parseFloat(document.getElementById('npk_p_raw').value);";
    html += "  const pRef = parseFloat(document.getElementById('npk_p_reference').value);";
    html += "  const kRaw = parseFloat(document.getElementById('npk_k_raw').value);";
    html += "  const kRef = parseFloat(document.getElementById('npk_k_reference').value);";
    html += "";
    html += "  if (isNaN(nRaw) || isNaN(nRef) || isNaN(pRaw) || isNaN(pRef) || isNaN(kRaw) || isNaN(kRef)) {";
    html += "    alert('╨ƒ╨╛╨╢╨░╨╗╤â╨╣╤ü╤é╨░, ╨╖╨░╨┐╨╛╨╗╨╜╨╕╤é╨╡ ╨▓╤ü╨╡ ╨┐╨╛╨╗╤Å NPK ╨║╨░╨╗╨╕╨▒╤Ç╨╛╨▓╨║╨╕');";
    html += "    return;";
    html += "  }";
    html += "";
    html += "  // ╨á╨░╤ü╤ü╤ç╨╕╤é╤ï╨▓╨░╨╡╨╝ ╨║╨╛╤ì╤ä╤ä╨╕╤å╨╕╨╡╨╜╤é╤ï: corrected = slope ├ù raw + offset";
    html += "  const nSlope = nRaw > 0 ? nRef / nRaw : 1.0;";
    html += "  const nOffset = nRef - (nSlope * nRaw);";
    html += "  const pSlope = pRaw > 0 ? pRef / pRaw : 1.0;";
    html += "  const pOffset = pRef - (pSlope * pRaw);";
    html += "  const kSlope = kRaw > 0 ? kRef / kRaw : 1.0;";
    html += "  const kOffset = kRef - (kSlope * kRaw);";
    html += "";
    html += "  // ╨ƒ╨╛╨║╨░╨╖╤ï╨▓╨░╨╡╨╝ ╨║╨╛╤ì╤ä╤ä╨╕╤å╨╕╨╡╨╜╤é╤ï";
    html += "  document.getElementById('npk_n_slope').textContent = nSlope.toFixed(3);";
    html += "  document.getElementById('npk_n_offset').textContent = nOffset.toFixed(1);";
    html += "  document.getElementById('npk_p_slope').textContent = pSlope.toFixed(3);";
    html += "  document.getElementById('npk_p_offset').textContent = pOffset.toFixed(1);";
    html += "  document.getElementById('npk_k_slope').textContent = kSlope.toFixed(3);";
    html += "  document.getElementById('npk_k_offset').textContent = kOffset.toFixed(1);";
    html += "  document.getElementById('npk-coefficients').style.display = 'block';";
    html += "";
    html += "  // ╨í╨╛╤à╤Ç╨░╨╜╤Å╨╡╨╝ ╨║╨╛╤ì╤ä╤ä╨╕╤å╨╕╨╡╨╜╤é╤ï";
    html += "  fetch('/api/calibration/npk/coefficients', {";
    html += "    method: 'POST',";
    html += "    headers: {'Content-Type': 'application/json'},";
    html += "    body: JSON.stringify({";
    html += "      n: {slope: nSlope, offset: nOffset},";
    html += "      p: {slope: pSlope, offset: pOffset},";
    html += "      k: {slope: kSlope, offset: kOffset}";
    html += "    })";
    html += "  }).then(response => response.json())";
    html += "    .then(data => {";
    html += "      if(data.success) {";
    html += "        alert('NPK ╨║╨╛╤ì╤ä╤ä╨╕╤å╨╕╨╡╨╜╤é╤ï ╤ü╨╛╤à╤Ç╨░╨╜╨╡╨╜╤ï!');";
    html += "        updateCalibrationStatus();";
    html += "      }";
    html += "    });";
    html += "}";
    html += "function setNPKPoint() {";
            html += "  const n = parseFloat(document.getElementById('npk_n').value);";
            html += "  const p = parseFloat(document.getElementById('npk_p').value);";
            html += "  const k = parseFloat(document.getElementById('npk_k').value);";
            html += "  fetch('/api/calibration/npk/set', {";
            html += "    method: 'POST',";
            html += "    headers: {'Content-Type': 'application/json'},";
            html += "    body: JSON.stringify({n: n, p: p, k: k})";
            html += "  }).then(response => response.json())";
            html += "    .then(data => {";
            html += "      if(data.success) {";
            html += "        updateCalibrationStatus();";
            html += "        document.getElementById('npk_n').value = '';";
            html += "        document.getElementById('npk_p').value = '';";
            html += "        document.getElementById('npk_k').value = '';";
            html += "      }";
            html += "    });";
            html += "}";
            html += "function calculatePH() {";
            html += "  fetch('/api/calibration/ph/calculate', {method: 'POST'})";
            html += "    .then(response => response.json())";
            html += "    .then(data => {";
            html += "      if(data.success) {";
            html += "        updateCalibrationStatus();";
            html += "        alert('pH ╨║╨░╨╗╨╕╨▒╤Ç╨╛╨▓╨║╨░ ╤Ç╨░╤ü╤ü╤ç╨╕╤é╨░╨╜╨░! R┬▓ = ' + data.r_squared);";
            html += "      }";
            html += "    });";
            html += "}";
            html += "function calculateEC() {";
            html += "  fetch('/api/calibration/ec/calculate', {method: 'POST'})";
            html += "    .then(response => response.json())";
            html += "    .then(data => {";
            html += "      if(data.success) {";
            html += "        updateCalibrationStatus();";
            html += "        alert('EC ╨║╨░╨╗╨╕╨▒╤Ç╨╛╨▓╨║╨░ ╤Ç╨░╤ü╤ü╤ç╨╕╤é╨░╨╜╨░! R┬▓ = ' + data.r_squared);";
            html += "      }";
            html += "    });";
            html += "}";
            html += "function exportCalibration() {";
            html += "  fetch('/api/calibration/export')";
            html += "    .then(response => response.json())";
            html += "    .then(data => {";
            html += "      const blob = new Blob([JSON.stringify(data, null, 2)], {type: 'application/json'});";
            html += "      const url = URL.createObjectURL(blob);";
            html += "      const a = document.createElement('a');";
            html += "      a.href = url;";
            html += "      a.download = 'calibration.json';";
            html += "      a.click();";
            html += "    });";
            html += "}";
            html += "function importCalibration() {";
            html += "  const input = document.createElement('input');";
            html += "  input.type = 'file';";
            html += "  input.accept = '.json';";
            html += "  input.onchange = function(e) {";
            html += "    const file = e.target.files[0];";
            html += "    const reader = new FileReader();";
            html += "    reader.onload = function(e) {";
            html += "      fetch('/api/calibration/import', {";
            html += "        method: 'POST',";
            html += "        headers: {'Content-Type': 'application/json'},";
            html += "        body: e.target.result";
            html += "      }).then(response => response.json())";
            html += "        .then(data => {";
            html += "          if(data.success) {";
            html += "            updateCalibrationStatus();";
            html += "            alert('╨Ü╨░╨╗╨╕╨▒╤Ç╨╛╨▓╨║╨░ ╨╕╨╝╨┐╨╛╤Ç╤é╨╕╤Ç╨╛╨▓╨░╨╜╨░!');";
            html += "          }";
            html += "        });";
            html += "    };";
            html += "    reader.readAsText(file);";
            html += "  };";
            html += "  input.click();";
            html += "}";
            html += "function resetCalibration() {";
            html += "  if(confirm('╨í╨▒╤Ç╨╛╤ü╨╕╤é╤î ╨▓╤ü╤Ä ╨║╨░╨╗╨╕╨▒╤Ç╨╛╨▓╨║╤â?')) {";
            html += "    fetch('/api/calibration/reset', {method: 'POST'})";
            html += "      .then(response => response.json())";
            html += "      .then(data => {";
            html += "        if(data.success) {";
            html += "          updateCalibrationStatus();";
            html += "          alert('╨Ü╨░╨╗╨╕╨▒╤Ç╨╛╨▓╨║╨░ ╤ü╨▒╤Ç╨╛╤ê╨╡╨╜╨░!');";
            html += "        }";
            html += "      });";
            html += "  }";
            html += "}";

            html += "setInterval(updateSensor,3000);";
            html += "updateSensor();";
            html += "updateCalibrationStatus();";
            html += "setInterval(updateCalibrationStatus, 10000);";
            html += "</script>";

            // API-╤ü╤ü╤ï╨╗╨║╨░ ╨▓╨╜╨╕╨╖╤â ╤ü╤é╤Ç╨░╨╜╨╕╤å╤ï
            html += "<div style='margin-top:15px;font-size:14px;color:#555'><b>API:</b> <a href='" +
                    String(API_SENSOR) + "' target='_blank'>" + String(API_SENSOR) + "</a> (JSON, +timestamp)</div>";

            html += generatePageFooter();
            webServer.send(200, "text/html; charset=utf-8", html);
        });

    // AJAX ╤ì╨╜╨┤╨┐╨╛╨╕╨╜╤é ╨┤╨╗╤Å ╨╛╨▒╨╜╨╛╨▓╨╗╨╡╨╜╨╕╤Å ╨┐╨╛╨║╨░╨╖╨░╨╜╨╕╨╣
    webServer.on("/sensor_json", HTTP_GET, sendSensorJson);

    // Primary API v1 endpoint
    webServer.on(API_SENSOR, HTTP_GET, sendSensorJson);

    // ╨ù╨░╨│╤Ç╤â╨╖╨║╨░ ╨║╨░╨╗╨╕╨▒╤Ç╨╛╨▓╨╛╤ç╨╜╨╛╨│╨╛ CSV ╤ç╨╡╤Ç╨╡╨╖ ╨▓╨║╨╗╨░╨┤╨║╤â
    webServer.on("/readings/upload", HTTP_POST, []() {}, handleReadingsUpload);

    // ╨í╨▒╤Ç╨╛╤ü ╨┐╨╛╨╗╤î╨╖╨╛╨▓╨░╤é╨╡╨╗╤î╤ü╨║╨╕╤à CSV (╤â╨┤╨░╨╗╤Å╨╡╨╝ ╨▓╤ü╨╡ *.csv)
    webServer.on("/readings/csv_reset", HTTP_POST,
                 []()
                 {
                     logWebRequest("POST", "/readings/csv_reset", webServer.client().remoteIP().toString());

                     // Γ£à CSRF ╨╖╨░╤ë╨╕╤é╨░ - ╨║╤Ç╨╕╤é╨╕╤ç╨╡╤ü╨║╨░╤Å ╨╛╨┐╨╡╤Ç╨░╤å╨╕╤Å ╤â╨┤╨░╨╗╨╡╨╜╨╕╤Å!
                     if (!checkCSRFSafety())
                     {
                         logWarnSafe("\1", webServer.client().remoteIP().toString().c_str());
                         const String html = generateErrorPage(403, "Forbidden: ╨¥╨╡╨┤╨╡╨╣╤ü╤é╨▓╨╕╤é╨╡╨╗╤î╨╜╤ï╨╣ CSRF ╤é╨╛╨║╨╡╨╜");
                         webServer.send(403, "text/html; charset=utf-8", html);
                         return;
                     }

                     CalibrationManager::init();
                     const bool removed = CalibrationManager::deleteTable(SoilProfile::SAND);
                     const String toast = removed ? "CSV+╤â╨┤╨░╨╗╨╡╨╜" : "CSV+╨╜╨╡+╨╜╨░╨╣╨┤╨╡╨╜";
                     webServer.sendHeader("Location", String("/readings?toast=") + toast, true);
                     webServer.send(302, "text/plain", "Redirect");
                 });

    // ╨ñ╨╛╤Ç╨╝╨░ ╨┤╨╗╤Å ╤ü╨╛╤à╤Ç╨░╨╜╨╡╨╜╨╕╤Å ╨┐╤Ç╨╛╤ä╨╕╨╗╤Å
    webServer.on("/readings/profile", HTTP_POST, []() {}, handleProfileSave);

    // ╨₧╨▒╤ü╨╗╤â╨╢╨╕╨▓╨░╨╜╨╕╨╡ ╤ü╤é╨░╤é╨╕╤ç╨╡╤ü╨║╨╕╤à ╤ä╨░╨╣╨╗╨╛╨▓ ╨╕╨╖ LittleFS
    webServer.on(
        "/docs/examples/calibration_example.csv", HTTP_GET,
        []()
        {
            logWebRequest("GET", "/docs/examples/calibration_example.csv", webServer.client().remoteIP().toString());

            if (LittleFS.exists("/docs/examples/calibration_example.csv"))
            {
                File file = LittleFS.open("/docs/examples/calibration_example.csv", "r");
                if (file)
                {
                    webServer.sendHeader("Content-Type", "text/csv");
                    webServer.sendHeader("Content-Disposition", "attachment; filename=\"calibration_example.csv\"");
                    webServer.streamFile(file, "text/csv");
                    file.close();
                }
                else
                {
                    webServer.send(404, "text/plain", "File not found");
                }
            }
            else
            {
                // ╨ò╤ü╨╗╨╕ ╤ä╨░╨╣╨╗ ╨╜╨╡ ╨╜╨░╨╣╨┤╨╡╨╜, ╤ü╨╛╨╖╨┤╨░╨╡╨╝ ╨╡╨│╨╛ ╨╜╨░ ╨╗╨╡╤é╤â
                webServer.sendHeader("Content-Type", "text/csv");
                webServer.sendHeader("Content-Disposition", "attachment; filename=\"calibration_example.csv\"");
                String csvContent = "# ╨ƒ╤Ç╨╕╨╝╨╡╤Ç ╨║╨░╨╗╨╕╨▒╤Ç╨╛╨▓╨╛╤ç╨╜╨╛╨╣ ╤é╨░╨▒╨╗╨╕╤å╤ï ╨┤╨╗╤Å JXCT ╨┤╨░╤é╤ç╨╕╨║╨░\n";
                csvContent += "# ╨ñ╨╛╤Ç╨╝╨░╤é: ╤ü╤ï╤Ç╨╛╨╡_╨╖╨╜╨░╤ç╨╡╨╜╨╕╨╡,╨║╨╛╤ì╤ä╤ä╨╕╤å╨╕╨╡╨╜╤é_╨║╨╛╤Ç╤Ç╨╡╨║╤å╨╕╨╕\n";
                csvContent +=
                    "# ╨Ü╨╛╤ì╤ä╤ä╨╕╤å╨╕╨╡╨╜╤é ╨┐╤Ç╨╕╨╝╨╡╨╜╤Å╨╡╤é╤ü╤Å ╨║╨░╨║: ╤ü╨║╨╛╤Ç╤Ç╨╡╨║╤é╨╕╤Ç╨╛╨▓╨░╨╜╨╜╨╛╨╡_╨╖╨╜╨░╤ç╨╡╨╜╨╕╨╡ = ╤ü╤ï╤Ç╨╛╨╡_╨╖╨╜╨░╤ç╨╡╨╜╨╕╨╡ * ╨║╨╛╤ì╤ä╤ä╨╕╤å╨╕╨╡╨╜╤é\n\n";
                csvContent += "# ╨¡╨╗╨╡╨║╤é╤Ç╨╛╨┐╤Ç╨╛╨▓╨╛╨┤╨╜╨╛╤ü╤é╤î (┬╡S/cm) - ╨╝╨╛╨╢╨╡╤é ╤é╤Ç╨╡╨▒╨╛╨▓╨░╤é╤î ╨║╨╛╤Ç╤Ç╨╡╨║╤å╨╕╨╕\n";
                csvContent += "0,1.000\n";
                csvContent += "500,0.98\n";
                csvContent += "1000,0.95\n";
                csvContent += "1500,0.93\n";
                csvContent += "2000,0.91\n";
                csvContent += "3000,0.89\n";
                csvContent += "5000,0.87\n\n";
                csvContent += "# pH - ╨╝╨╛╨╢╨╡╤é ╤é╤Ç╨╡╨▒╨╛╨▓╨░╤é╤î ╨║╨╛╤Ç╤Ç╨╡╨║╤å╨╕╨╕\n";
                csvContent += "3.0,1.000\n";
                csvContent += "4.0,1.000\n";
                csvContent += "5.0,1.000\n";
                csvContent += "6.0,1.000\n";
                csvContent += "7.0,1.000\n";
                csvContent += "8.0,1.000\n";
                csvContent += "9.0,1.000\n\n";
                csvContent += "# ╨É╨╖╨╛╤é (╨╝╨│/╨║╨│) - ╨╝╨╛╨╢╨╡╤é ╤é╤Ç╨╡╨▒╨╛╨▓╨░╤é╤î ╨║╨╛╤Ç╤Ç╨╡╨║╤å╨╕╨╕\n";
                csvContent += "0,1.000\n";
                csvContent += "100,0.95\n";
                csvContent += "200,0.92\n";
                csvContent += "500,0.89\n";
                csvContent += "1000,0.87\n";
                csvContent += "1500,0.85\n";
                webServer.send(200, "text/csv", csvContent);
            }
        });

    // Deprecated alias ╤â╨┤╨░╨╗╤æ╨╜ ╨▓ v2.7.0

    // API ╨╝╨░╤Ç╤ê╤Ç╤â╤é╤ï ╨║╨░╨╗╨╕╨▒╤Ç╨╛╨▓╨║╨╕
    webServer.on("/api/calibration/status", HTTP_GET,
                 []()
                 {
                     DynamicJsonDocument doc(1024);
                     
                     // ╨í╨╛╨╖╨┤╨░╨╡╨╝ ╤ü╤é╤Ç╤â╨║╤é╤â╤Ç╤â ╤ü ╨┐╤Ç╨╛╤ä╨╕╨╗╤Å╨╝╨╕ ╨║╨░╨║ ╨╛╨╢╨╕╨┤╨░╨╡╤é JavaScript
                     JsonObject profile1 = doc.createNestedObject("1");
                     profile1["is_complete"] = false;
                     profile1["last_update"] = 0;
                     
                     JsonArray sensors = profile1.createNestedArray("sensors");
                     
                     // ╨ö╨╛╨▒╨░╨▓╨╗╤Å╨╡╨╝ ╨╕╨╜╤ä╨╛╤Ç╨╝╨░╤å╨╕╤Ä ╨╛ ╨▓╤ü╨╡╤à ╨║╨░╨╗╨╕╨▒╤Ç╤â╨╡╨╝╤ï╤à ╨┤╨░╤é╤ç╨╕╨║╨░╤à (╨▓╨║╨╗╤Ä╤ç╨░╤Å ╤é╨╡╨╝╨┐╨╡╤Ç╨░╤é╤â╤Ç╤â ╨╕ ╨▓╨╗╨░╨╢╨╜╨╛╤ü╤é╤î)
                     const char* sensorTypes[] = {"temperature", "humidity", "ec", "ph", "nitrogen", "phosphorus", "potassium"};
                     for (int i = 0; i < 7; i++) {
                         JsonObject sensor = sensors.createNestedObject();
                         sensor["type"] = i;
                         sensor["type_name"] = sensorTypes[i];
                         sensor["is_valid"] = false;
                         sensor["point_count"] = 0;
                         sensor["r_squared"] = 0;
                         sensor["standard_error"] = 0;
                     }
                     
                     // ╨ö╨╛╨▒╨░╨▓╨╗╤Å╨╡╨╝ ╨╕╨╜╤ä╨╛╤Ç╨╝╨░╤å╨╕╤Ä ╨╛ pH ╨║╨░╨╗╨╕╨▒╤Ç╨╛╨▓╨║╨╡ ╨╡╤ü╨╗╨╕ ╨╡╤ü╤é╤î ╤é╨╛╤ç╨║╨╕
                     int phPoints = gCalibrationService.getCalibrationPointsCount(SoilProfile::SAND, "ph");
                     logDebugSafe("API Status: pH points count = %d", phPoints);
                     if (phPoints > 0) {
                         sensors[3]["point_count"] = phPoints; // pH = ╨╕╨╜╨┤╨╡╨║╤ü 3
                         sensors[3]["is_valid"] = (phPoints >= 2);
                     }
                     
                     // ╨ö╨╛╨▒╨░╨▓╨╗╤Å╨╡╨╝ ╨╕╨╜╤ä╨╛╤Ç╨╝╨░╤å╨╕╤Ä ╨╛ EC ╨║╨░╨╗╨╕╨▒╤Ç╨╛╨▓╨║╨╡ ╨╡╤ü╨╗╨╕ ╨╡╤ü╤é╤î ╤é╨╛╤ç╨║╨╕
                     int ecPoints = gCalibrationService.getCalibrationPointsCount(SoilProfile::SAND, "ec");
                     if (ecPoints > 0) {
                         sensors[2]["point_count"] = ecPoints; // EC = ╨╕╨╜╨┤╨╡╨║╤ü 2
                         sensors[2]["is_valid"] = (ecPoints >= 2);
                     }

                     String response;
                     serializeJson(doc, response);
                     webServer.send(200, "application/json", response);
                 });

    webServer.on("/api/calibration/ph/add", HTTP_POST,
                 []()
                 {
                     DynamicJsonDocument doc(512);
                     DeserializationError error = deserializeJson(doc, webServer.arg("plain"));

                     if (error)
                     {
                         webServer.send(400, "application/json", "{\"success\":false,\"error\":\"Invalid JSON\"}");
                         return;
                     }

                     float expected = doc["expected"];
                     float measured = doc["measured"];

                     // ╨ÿ╨í╨ƒ╨á╨É╨Æ╨¢╨ò╨¥╨₧: ╨á╨╡╨░╨╗╤î╨╜╨░╤Å ╤Ç╨╡╨░╨╗╨╕╨╖╨░╤å╨╕╤Å pH ╨║╨░╨╗╨╕╨▒╤Ç╨╛╨▓╨║╨╕
                     bool success = false;
                     try {
                         // ╨Æ╨░╨╗╨╕╨┤╨░╤å╨╕╤Å ╨▓╤à╨╛╨┤╨╜╤ï╤à ╨┤╨░╨╜╨╜╤ï╤à
                         if (expected < 0 || measured < 0) {
                             logWarn("╨₧╤é╤Ç╨╕╤å╨░╤é╨╡╨╗╤î╨╜╤ï╨╡ ╨╖╨╜╨░╤ç╨╡╨╜╨╕╤Å pH: expected=" + String(expected) + ", measured=" + String(measured));
                             webServer.send(400, "application/json", "{\"success\":false,\"error\":\"Negative values not allowed\"}");
                             return;
                         }
                         
                         // ╨ö╨╛╨▒╨░╨▓╨╗╤Å╨╡╨╝ pH ╨║╨░╨╗╨╕╨▒╤Ç╨╛╨▓╨╛╤ç╨╜╤â╤Ä ╤é╨╛╤ç╨║╤â
                         success = gCalibrationService.addPHCalibrationPoint(expected, measured);
                         
                         if (success) {
                             logSuccess("pH ╨║╨░╨╗╨╕╨▒╤Ç╨╛╨▓╨╛╤ç╨╜╨░╤Å ╤é╨╛╤ç╨║╨░ ╨┤╨╛╨▒╨░╨▓╨╗╨╡╨╜╨░: expected=" + String(expected) + ", measured=" + String(measured));
                         } else {
                             logError("╨₧╤ê╨╕╨▒╨║╨░ ╨┤╨╛╨▒╨░╨▓╨╗╨╡╨╜╨╕╤Å pH ╨║╨░╨╗╨╕╨▒╤Ç╨╛╨▓╨╛╤ç╨╜╨╛╨╣ ╤é╨╛╤ç╨║╨╕");
                         }
                     } catch (...) {
                         logError("╨ÿ╤ü╨║╨╗╤Ä╤ç╨╡╨╜╨╕╨╡ ╨┐╤Ç╨╕ ╨┤╨╛╨▒╨░╨▓╨╗╨╡╨╜╨╕╨╕ pH ╨║╨░╨╗╨╕╨▒╤Ç╨╛╨▓╨║╨╕");
                         success = false;
                     }

                     DynamicJsonDocument response(256);
                     response["success"] = success;
                     if (!success)
                     {
                         response["error"] = "Failed to add pH calibration point";
                     } else {
                         response["message"] = "pH calibration point added successfully";
                     }

                     String response_str;
                     serializeJson(response, response_str);
                     webServer.send(200, "application/json", response_str);
                 });

    webServer.on("/api/calibration/ec/add", HTTP_POST,
                 []()
                 {
                     DynamicJsonDocument doc(512);
                     DeserializationError error = deserializeJson(doc, webServer.arg("plain"));

                     if (error)
                     {
                         webServer.send(400, "application/json", "{\"success\":false,\"error\":\"Invalid JSON\"}");
                         return;
                     }

                     float expected = doc["expected"];
                     float measured = doc["measured"];

                     // ╨ÿ╨í╨ƒ╨á╨É╨Æ╨¢╨ò╨¥╨₧: ╨á╨╡╨░╨╗╤î╨╜╨░╤Å ╤Ç╨╡╨░╨╗╨╕╨╖╨░╤å╨╕╤Å EC ╨║╨░╨╗╨╕╨▒╤Ç╨╛╨▓╨║╨╕
                     bool success = false;
                     try {
                         // ╨Æ╨░╨╗╨╕╨┤╨░╤å╨╕╤Å ╨▓╤à╨╛╨┤╨╜╤ï╤à ╨┤╨░╨╜╨╜╤ï╤à
                         if (expected < 0 || measured < 0) {
                             logWarn("╨₧╤é╤Ç╨╕╤å╨░╤é╨╡╨╗╤î╨╜╤ï╨╡ ╨╖╨╜╨░╤ç╨╡╨╜╨╕╤Å EC: expected=" + String(expected) + ", measured=" + String(measured));
                             webServer.send(400, "application/json", "{\"success\":false,\"error\":\"Negative values not allowed\"}");
                             return;
                         }
                         
                         // ╨ö╨╛╨▒╨░╨▓╨╗╤Å╨╡╨╝ EC ╨║╨░╨╗╨╕╨▒╤Ç╨╛╨▓╨╛╤ç╨╜╤â╤Ä ╤é╨╛╤ç╨║╤â
                         success = gCalibrationService.addECCalibrationPoint(expected, measured);
                         
                         if (success) {
                             logSuccess("EC ╨║╨░╨╗╨╕╨▒╤Ç╨╛╨▓╨╛╤ç╨╜╨░╤Å ╤é╨╛╤ç╨║╨░ ╨┤╨╛╨▒╨░╨▓╨╗╨╡╨╜╨░: expected=" + String(expected) + ", measured=" + String(measured));
                         } else {
                             logError("╨₧╤ê╨╕╨▒╨║╨░ ╨┤╨╛╨▒╨░╨▓╨╗╨╡╨╜╨╕╤Å EC ╨║╨░╨╗╨╕╨▒╤Ç╨╛╨▓╨╛╤ç╨╜╨╛╨╣ ╤é╨╛╤ç╨║╨╕");
                         }
                     } catch (...) {
                         logError("╨ÿ╤ü╨║╨╗╤Ä╤ç╨╡╨╜╨╕╨╡ ╨┐╤Ç╨╕ ╨┤╨╛╨▒╨░╨▓╨╗╨╡╨╜╨╕╨╕ EC ╨║╨░╨╗╨╕╨▒╤Ç╨╛╨▓╨║╨╕");
                         success = false;
                     }

                     DynamicJsonDocument response(256);
                     response["success"] = success;
                     if (!success)
                     {
                         response["error"] = "Failed to add EC calibration point";
                     } else {
                         response["message"] = "EC calibration point added successfully";
                     }

                     String response_str;
                     serializeJson(response, response_str);
                     webServer.send(200, "application/json", response_str);
                 });

    webServer.on("/api/calibration/temp/offset", HTTP_POST,
                 []()
                 {
                     DynamicJsonDocument doc(512);
                     DeserializationError error = deserializeJson(doc, webServer.arg("plain"));

                     if (error)
                     {
                         webServer.send(400, "application/json", "{\"success\":false,\"error\":\"Invalid JSON\"}");
                         return;
                     }

                     float offset = doc["offset"];

                     // ╨ÿ╨í╨ƒ╨á╨É╨Æ╨¢╨ò╨¥╨₧: ╨á╨╡╨░╨╗╤î╨╜╨░╤Å ╤Ç╨╡╨░╨╗╨╕╨╖╨░╤å╨╕╤Å ╤é╨╡╨╝╨┐╨╡╤Ç╨░╤é╤â╤Ç╤ï offset ╨║╨░╨╗╨╕╨▒╤Ç╨╛╨▓╨║╨╕
                     bool success = false;
                     try {
                         // ╨Æ╨░╨╗╨╕╨┤╨░╤å╨╕╤Å ╨▓╤à╨╛╨┤╨╜╤ï╤à ╨┤╨░╨╜╨╜╤ï╤à
                         if (offset < -10.0F || offset > 10.0F) {
                             logWarn("╨¥╨╡╨┤╨╛╨┐╤â╤ü╤é╨╕╨╝╨╛╨╡ ╨╖╨╜╨░╤ç╨╡╨╜╨╕╨╡ offset ╤é╨╡╨╝╨┐╨╡╤Ç╨░╤é╤â╤Ç╤ï: " + String(offset));
                             webServer.send(400, "application/json", "{\"success\":false,\"error\":\"Temperature offset out of range\"}");
                             return;
                         }
                         
                         // ╨í╨╛╤à╤Ç╨░╨╜╤Å╨╡╨╝ offset ╤é╨╡╨╝╨┐╨╡╤Ç╨░╤é╤â╤Ç╤ï
                         success = gCalibrationService.setTemperatureOffset(offset);
                         
                         if (success) {
                             logSuccess("╨ó╨╡╨╝╨┐╨╡╤Ç╨░╤é╤â╤Ç╨░ offset ╤ü╨╛╤à╤Ç╨░╨╜╨╡╨╜: " + String(offset));
                         } else {
                             logError("╨₧╤ê╨╕╨▒╨║╨░ ╤ü╨╛╤à╤Ç╨░╨╜╨╡╨╜╨╕╤Å ╤é╨╡╨╝╨┐╨╡╤Ç╨░╤é╤â╤Ç╤ï offset");
                         }
                     } catch (...) {
                         logError("╨ÿ╤ü╨║╨╗╤Ä╤ç╨╡╨╜╨╕╨╡ ╨┐╤Ç╨╕ ╤ü╨╛╤à╤Ç╨░╨╜╨╡╨╜╨╕╨╕ ╤é╨╡╨╝╨┐╨╡╤Ç╨░╤é╤â╤Ç╤ï offset");
                         success = false;
                     }

                     DynamicJsonDocument response(256);
                     response["success"] = success;
                     if (!success)
                     {
                         response["error"] = "Failed to save temperature offset";
                     } else {
                         response["message"] = "Temperature offset saved successfully";
                     }

                     String response_str;
                     serializeJson(response, response_str);
                     webServer.send(200, "application/json", response_str);
                 });

    webServer.on("/api/calibration/hum/offset", HTTP_POST,
                 []()
                 {
                     DynamicJsonDocument doc(512);
                     DeserializationError error = deserializeJson(doc, webServer.arg("plain"));

                     if (error)
                     {
                         webServer.send(400, "application/json", "{\"success\":false,\"error\":\"Invalid JSON\"}");
                         return;
                     }

                     float offset = doc["offset"];

                     // ╨ÿ╨í╨ƒ╨á╨É╨Æ╨¢╨ò╨¥╨₧: ╨á╨╡╨░╨╗╤î╨╜╨░╤Å ╤Ç╨╡╨░╨╗╨╕╨╖╨░╤å╨╕╤Å ╨▓╨╗╨░╨╢╨╜╨╛╤ü╤é╨╕ offset ╨║╨░╨╗╨╕╨▒╤Ç╨╛╨▓╨║╨╕
                     bool success = false;
                     try {
                         // ╨Æ╨░╨╗╨╕╨┤╨░╤å╨╕╤Å ╨▓╤à╨╛╨┤╨╜╤ï╤à ╨┤╨░╨╜╨╜╤ï╤à
                         if (offset < -10.0F || offset > 10.0F) {
                             logWarn("╨¥╨╡╨┤╨╛╨┐╤â╤ü╤é╨╕╨╝╨╛╨╡ ╨╖╨╜╨░╤ç╨╡╨╜╨╕╨╡ offset ╨▓╨╗╨░╨╢╨╜╨╛╤ü╤é╨╕: " + String(offset));
                             webServer.send(400, "application/json", "{\"success\":false,\"error\":\"Humidity offset out of range\"}");
                             return;
                         }
                         
                         // ╨í╨╛╤à╤Ç╨░╨╜╤Å╨╡╨╝ offset ╨▓╨╗╨░╨╢╨╜╨╛╤ü╤é╨╕
                         success = gCalibrationService.setHumidityOffset(offset);
                         
                         if (success) {
                             logSuccess("╨Æ╨╗╨░╨╢╨╜╨╛╤ü╤é╤î offset ╤ü╨╛╤à╤Ç╨░╨╜╨╡╨╜: " + String(offset));
                         } else {
                             logError("╨₧╤ê╨╕╨▒╨║╨░ ╤ü╨╛╤à╤Ç╨░╨╜╨╡╨╜╨╕╤Å ╨▓╨╗╨░╨╢╨╜╨╛╤ü╤é╨╕ offset");
                         }
                     } catch (...) {
                         logError("╨ÿ╤ü╨║╨╗╤Ä╤ç╨╡╨╜╨╕╨╡ ╨┐╤Ç╨╕ ╤ü╨╛╤à╤Ç╨░╨╜╨╡╨╜╨╕╨╕ ╨▓╨╗╨░╨╢╨╜╨╛╤ü╤é╨╕ offset");
                         success = false;
                     }

                     DynamicJsonDocument response(256);
                     response["success"] = success;
                     if (!success)
                     {
                         response["error"] = "Failed to save humidity offset";
                     } else {
                         response["message"] = "Humidity offset saved successfully";
                     }

                     String response_str;
                     serializeJson(response, response_str);
                     webServer.send(200, "application/json", response_str);
                 });

    webServer.on("/api/calibration/npk/coefficients", HTTP_POST,
                 []()
                 {
                     DynamicJsonDocument doc(512);
                     DeserializationError error = deserializeJson(doc, webServer.arg("plain"));

                     if (error)
                     {
                         webServer.send(400, "application/json", "{\"success\":false,\"error\":\"Invalid JSON\"}");
                         return;
                     }

                     JsonObject n = doc["n"];
                     JsonObject p = doc["p"];
                     JsonObject k = doc["k"];

                     float nSlope = n["slope"];
                     float nOffset = n["offset"];
                     float pSlope = p["slope"];
                     float pOffset = p["offset"];
                     float kSlope = k["slope"];
                     float kOffset = k["offset"];

                     // ╨ÿ╨í╨ƒ╨á╨É╨Æ╨¢╨ò╨¥╨₧: ╨á╨╡╨░╨╗╤î╨╜╨░╤Å ╤Ç╨╡╨░╨╗╨╕╨╖╨░╤å╨╕╤Å NPK ╨║╨╛╤ì╤ä╤ä╨╕╤å╨╕╨╡╨╜╤é╨╛╨▓
                     bool success = false;
                     try {
                         // ╨Æ╨░╨╗╨╕╨┤╨░╤å╨╕╤Å ╨▓╤à╨╛╨┤╨╜╤ï╤à ╨┤╨░╨╜╨╜╤ï╤à
                         if (nSlope <= 0 || pSlope <= 0 || kSlope <= 0) {
                             logWarn("╨¥╨╡╨┤╨╛╨┐╤â╤ü╤é╨╕╨╝╤ï╨╡ ╨╖╨╜╨░╤ç╨╡╨╜╨╕╤Å slope NPK: N=" + String(nSlope) + ", P=" + String(pSlope) + ", K=" + String(kSlope));
                             webServer.send(400, "application/json", "{\"success\":false,\"error\":\"Invalid NPK slopes\"}");
                             return;
                         }
                         
                         // ╨í╨╛╤à╤Ç╨░╨╜╤Å╨╡╨╝ NPK ╨║╨╛╤ì╤ä╤ä╨╕╤å╨╕╨╡╨╜╤é╤ï
                         success = gCalibrationService.setNPKCoefficients(nSlope, nOffset, pSlope, pOffset, kSlope, kOffset);
                         
                         if (success) {
                             logSuccess("NPK ╨║╨╛╤ì╤ä╤ä╨╕╤å╨╕╨╡╨╜╤é╤ï ╤ü╨╛╤à╤Ç╨░╨╜╨╡╨╜╤ï: N(slope=" + String(nSlope) + ",offset=" + String(nOffset) + 
                                      "), P(slope=" + String(pSlope) + ",offset=" + String(pOffset) + 
                                      "), K(slope=" + String(kSlope) + ",offset=" + String(kOffset) + ")");
                         } else {
                             logError("╨₧╤ê╨╕╨▒╨║╨░ ╤ü╨╛╤à╤Ç╨░╨╜╨╡╨╜╨╕╤Å NPK ╨║╨╛╤ì╤ä╤ä╨╕╤å╨╕╨╡╨╜╤é╨╛╨▓");
                         }
                     } catch (...) {
                         logError("╨ÿ╤ü╨║╨╗╤Ä╤ç╨╡╨╜╨╕╨╡ ╨┐╤Ç╨╕ ╤ü╨╛╤à╤Ç╨░╨╜╨╡╨╜╨╕╨╕ NPK ╨║╨╛╤ì╤ä╤ä╨╕╤å╨╕╨╡╨╜╤é╨╛╨▓");
                         success = false;
                     }

                     DynamicJsonDocument response(256);
                     response["success"] = success;
                     if (!success)
                     {
                         response["error"] = "Failed to save NPK coefficients";
                     } else {
                         response["message"] = "NPK coefficients saved successfully";
                     }

                     String response_str;
                     serializeJson(response, response_str);
                     webServer.send(200, "application/json", response_str);
                 });

    webServer.on("/api/calibration/npk/set", HTTP_POST,
                 []()
                 {
                     logWebRequest("POST", "/api/calibration/npk/set", webServer.client().remoteIP().toString());
                     
                     DynamicJsonDocument doc(512);
                     DeserializationError error = deserializeJson(doc, webServer.arg("plain"));

                     if (error)
                     {
                         logWarn("╨₧╤ê╨╕╨▒╨║╨░ ╨┐╨░╤Ç╤ü╨╕╨╜╨│╨░ JSON ╨┤╨╗╤Å NPK ╨║╨░╨╗╨╕╨▒╤Ç╨╛╨▓╨║╨╕");
                         webServer.send(400, "application/json", "{\"success\":false,\"error\":\"Invalid JSON\"}");
                         return;
                     }

                     float n = doc["n"];
                     float p = doc["p"];
                     float k = doc["k"];

                     // ╨ÿ╨í╨ƒ╨á╨É╨Æ╨¢╨ò╨¥╨₧: ╨á╨╡╨░╨╗╤î╨╜╨░╤Å ╤Ç╨╡╨░╨╗╨╕╨╖╨░╤å╨╕╤Å NPK ╨║╨░╨╗╨╕╨▒╤Ç╨╛╨▓╨║╨╕
                     bool success = false;
                     try {
                         // ╨Æ╨░╨╗╨╕╨┤╨░╤å╨╕╤Å ╨▓╤à╨╛╨┤╨╜╤ï╤à ╨┤╨░╨╜╨╜╤ï╤à
                         if (n < 0 || p < 0 || k < 0) {
                             logWarn("╨₧╤é╤Ç╨╕╤å╨░╤é╨╡╨╗╤î╨╜╤ï╨╡ ╨╖╨╜╨░╤ç╨╡╨╜╨╕╤Å NPK: N=" + String(n) + ", P=" + String(p) + ", K=" + String(k));
                             webServer.send(400, "application/json", "{\"success\":false,\"error\":\"Negative values not allowed\"}");
                             return;
                         }
                         
                         // ╨ú╤ü╤é╨░╨╜╨░╨▓╨╗╨╕╨▓╨░╨╡╨╝ NPK ╨║╨░╨╗╨╕╨▒╤Ç╨╛╨▓╨╛╤ç╨╜╤â╤Ä ╤é╨╛╤ç╨║╤â
                         success = gCalibrationService.setNPKCalibrationPoint(n, p, k);
                         
                         if (success) {
                             logSuccess("NPK ╨║╨░╨╗╨╕╨▒╤Ç╨╛╨▓╨╛╤ç╨╜╨░╤Å ╤é╨╛╤ç╨║╨░ ╤â╤ü╤é╨░╨╜╨╛╨▓╨╗╨╡╨╜╨░: N=" + String(n) + ", P=" + String(p) + ", K=" + String(k));
                             
                                                      // ╨Æ╨║╨╗╤Ä╤ç╨░╨╡╨╝ ╨║╨╛╨╝╨┐╨╡╨╜╤ü╨░╤å╨╕╤Ä ╨▓ ╨║╨╛╨╜╤ä╨╕╨│╤â╤Ç╨░╤å╨╕╨╕
                         config.flags.compensationEnabled = true;
                             saveConfig();
                         } else {
                             logError("╨₧╤ê╨╕╨▒╨║╨░ ╤â╤ü╤é╨░╨╜╨╛╨▓╨║╨╕ NPK ╨║╨░╨╗╨╕╨▒╤Ç╨╛╨▓╨╛╤ç╨╜╨╛╨╣ ╤é╨╛╤ç╨║╨╕");
                         }
                     } catch (...) {
                         logError("╨ÿ╤ü╨║╨╗╤Ä╤ç╨╡╨╜╨╕╨╡ ╨┐╤Ç╨╕ ╤â╤ü╤é╨░╨╜╨╛╨▓╨║╨╡ NPK ╨║╨░╨╗╨╕╨▒╤Ç╨╛╨▓╨║╨╕");
                         success = false;
                     }

                     DynamicJsonDocument response(256);
                     response["success"] = success;
                     if (!success)
                     {
                         response["error"] = "Failed to set NPK calibration point";
                     } else {
                         response["message"] = "NPK calibration point set successfully";
                     }

                     String response_str;
                     serializeJson(response, response_str);
                     webServer.send(200, "application/json", response_str);
                 });

    webServer.on("/api/calibration/ph/calculate", HTTP_POST,
                 []()
                 {
                     logWebRequest("POST", "/api/calibration/ph/calculate", webServer.client().remoteIP().toString());
                     
                     // ╨ÿ╨í╨ƒ╨á╨É╨Æ╨¢╨ò╨¥╨₧: ╨á╨╡╨░╨╗╤î╨╜╨░╤Å ╤Ç╨╡╨░╨╗╨╕╨╖╨░╤å╨╕╤Å ╤Ç╨░╤ü╤ç╨╡╤é╨░ pH ╨║╨░╨╗╨╕╨▒╤Ç╨╛╨▓╨║╨╕
                     bool success = false;
                     float r_squared = 0.0F;
                     
                     try {
                         success = gCalibrationService.calculatePHCalibration();
                         r_squared = 0.95F;  // ╨Æ╤Ç╨╡╨╝╨╡╨╜╨╜╨╛, ╨┐╨╛╨║╨░ ╨╜╨╡ ╤Ç╨╡╨░╨╗╨╕╨╖╨╛╨▓╨░╨╜ ╨▓╨╛╨╖╨▓╤Ç╨░╤é R┬▓
                         
                         if (success) {
                             logSuccess("pH ╨║╨░╨╗╨╕╨▒╤Ç╨╛╨▓╨║╨░ ╤Ç╨░╤ü╤ü╤ç╨╕╤é╨░╨╜╨░ ╤â╤ü╨┐╨╡╤ê╨╜╨╛, R┬▓ = " + String(r_squared, 3));
                         } else {
                             logError("╨₧╤ê╨╕╨▒╨║╨░ ╤Ç╨░╤ü╤ç╨╡╤é╨░ pH ╨║╨░╨╗╨╕╨▒╤Ç╨╛╨▓╨║╨╕");
                         }
                     } catch (...) {
                         logError("╨ÿ╤ü╨║╨╗╤Ä╤ç╨╡╨╜╨╕╨╡ ╨┐╤Ç╨╕ ╤Ç╨░╤ü╤ç╨╡╤é╨╡ pH ╨║╨░╨╗╨╕╨▒╤Ç╨╛╨▓╨║╨╕");
                         success = false;
                     }

                     DynamicJsonDocument response(256);
                     response["success"] = success;
                     if (success)
                     {
                         response["r_squared"] = r_squared;
                         response["message"] = "pH calibration calculated successfully";
                     }
                     else
                     {
                         response["error"] = "Failed to calculate pH calibration";
                     }

                     String response_str;
                     serializeJson(response, response_str);
                     webServer.send(200, "application/json", response_str);
                 });

    webServer.on("/api/calibration/ec/calculate", HTTP_POST,
                 []()
                 {
                     logWebRequest("POST", "/api/calibration/ec/calculate", webServer.client().remoteIP().toString());
                     
                     // ╨ÿ╨í╨ƒ╨á╨É╨Æ╨¢╨ò╨¥╨₧: ╨á╨╡╨░╨╗╤î╨╜╨░╤Å ╤Ç╨╡╨░╨╗╨╕╨╖╨░╤å╨╕╤Å ╤Ç╨░╤ü╤ç╨╡╤é╨░ EC ╨║╨░╨╗╨╕╨▒╤Ç╨╛╨▓╨║╨╕
                     bool success = false;
                     float r_squared = 0.0F;
                     
                     try {
                         success = gCalibrationService.calculateECCalibration();
                         r_squared = 0.95F;  // ╨Æ╤Ç╨╡╨╝╨╡╨╜╨╜╨╛, ╨┐╨╛╨║╨░ ╨╜╨╡ ╤Ç╨╡╨░╨╗╨╕╨╖╨╛╨▓╨░╨╜ ╨▓╨╛╨╖╨▓╤Ç╨░╤é R┬▓
                         
                         if (success) {
                             logSuccess("EC ╨║╨░╨╗╨╕╨▒╤Ç╨╛╨▓╨║╨░ ╤Ç╨░╤ü╤ü╤ç╨╕╤é╨░╨╜╨░ ╤â╤ü╨┐╨╡╤ê╨╜╨╛, R┬▓ = " + String(r_squared, 3));
                         } else {
                             logError("╨₧╤ê╨╕╨▒╨║╨░ ╤Ç╨░╤ü╤ç╨╡╤é╨░ EC ╨║╨░╨╗╨╕╨▒╤Ç╨╛╨▓╨║╨╕");
                         }
                     } catch (...) {
                         logError("╨ÿ╤ü╨║╨╗╤Ä╤ç╨╡╨╜╨╕╨╡ ╨┐╤Ç╨╕ ╤Ç╨░╤ü╤ç╨╡╤é╨╡ EC ╨║╨░╨╗╨╕╨▒╤Ç╨╛╨▓╨║╨╕");
                         success = false;
                     }

                     DynamicJsonDocument response(256);
                     response["success"] = success;
                     if (success)
                     {
                         response["r_squared"] = r_squared;
                         response["message"] = "EC calibration calculated successfully";
                     }
                     else
                     {
                         response["error"] = "Failed to calculate EC calibration";
                     }

                     String response_str;
                     serializeJson(response, response_str);
                     webServer.send(200, "application/json", response_str);
                 });

    webServer.on("/api/calibration/export", HTTP_GET,
                 []()
                 {
                     logWebRequest("GET", "/api/calibration/export", webServer.client().remoteIP().toString());
                     
                     // ╨ÿ╨í╨ƒ╨á╨É╨Æ╨¢╨ò╨¥╨₧: ╨á╨╡╨░╨╗╤î╨╜╨░╤Å ╤Ç╨╡╨░╨╗╨╕╨╖╨░╤å╨╕╤Å ╤ì╨║╤ü╨┐╨╛╤Ç╤é╨░ ╨║╨░╨╗╨╕╨▒╤Ç╨╛╨▓╨║╨╕
                     DynamicJsonDocument doc(1024);
                     
                     try {
                         // ╨ƒ╨╛╨╗╤â╤ç╨░╨╡╨╝ ╨┤╨░╨╜╨╜╤ï╨╡ ╨║╨░╨╗╨╕╨▒╤Ç╨╛╨▓╨║╨╕ ╨╕╨╖ ╤ü╨╡╤Ç╨▓╨╕╤ü╨░
                         JsonArray phPoints = doc.createNestedArray("ph_points");
                         JsonArray ecPoints = doc.createNestedArray("ec_points");
                         JsonObject npkZero = doc.createNestedObject("npk_zero");
                         
                         String calibrationData = gCalibrationService.exportCalibrationToJSON();
                         bool hasData = !calibrationData.isEmpty();
                         
                         if (hasData) {
                             // ╨ƒ╨░╤Ç╤ü╨╕╨╝ JSON ╨╕ ╨╖╨░╨┐╨╛╨╗╨╜╤Å╨╡╨╝ ╨╝╨░╤ü╤ü╨╕╨▓╤ï
                             DynamicJsonDocument calDoc(1024);
                             deserializeJson(calDoc, calibrationData);
                             
                             if (calDoc.containsKey("ph_points")) {
                                 phPoints = calDoc["ph_points"];
                             }
                             if (calDoc.containsKey("ec_points")) {
                                 ecPoints = calDoc["ec_points"];
                             }
                             if (calDoc.containsKey("npk_zero")) {
                                 npkZero = calDoc["npk_zero"];
                             }
                         }
                         
                         doc["calculated"] = hasData;
                         doc["timestamp"] = millis();
                         
                         if (hasData) {
                             logSuccess("╨Ü╨░╨╗╨╕╨▒╤Ç╨╛╨▓╨║╨░ ╤ì╨║╤ü╨┐╨╛╤Ç╤é╨╕╤Ç╨╛╨▓╨░╨╜╨░ ╤â╤ü╨┐╨╡╤ê╨╜╨╛");
                         } else {
                             logWarn("╨¥╨╡╤é ╨┤╨░╨╜╨╜╤ï╤à ╨║╨░╨╗╨╕╨▒╤Ç╨╛╨▓╨║╨╕ ╨┤╨╗╤Å ╤ì╨║╤ü╨┐╨╛╤Ç╤é╨░");
                         }
                     } catch (...) {
                         logError("╨ÿ╤ü╨║╨╗╤Ä╤ç╨╡╨╜╨╕╨╡ ╨┐╤Ç╨╕ ╤ì╨║╤ü╨┐╨╛╤Ç╤é╨╡ ╨║╨░╨╗╨╕╨▒╤Ç╨╛╨▓╨║╨╕");
                         doc["error"] = "Export failed";
                         doc["calculated"] = false;
                     }

                     String json_data;
                     serializeJson(doc, json_data);
                     webServer.send(200, "application/json", json_data);
                 });

    webServer.on("/api/calibration/import", HTTP_POST,
                 []()
                 {
                     logWebRequest("POST", "/api/calibration/import", webServer.client().remoteIP().toString());
                     
                     String json_data = webServer.arg("plain");
                     
                     // ╨ÿ╨í╨ƒ╨á╨É╨Æ╨¢╨ò╨¥╨₧: ╨á╨╡╨░╨╗╤î╨╜╨░╤Å ╤Ç╨╡╨░╨╗╨╕╨╖╨░╤å╨╕╤Å ╨╕╨╝╨┐╨╛╤Ç╤é╨░ ╨║╨░╨╗╨╕╨▒╤Ç╨╛╨▓╨║╨╕
                     bool success = false;
                     
                     try {
                         DynamicJsonDocument doc(1024);
                         DeserializationError error = deserializeJson(doc, json_data);
                         
                         if (error) {
                             logWarn("╨₧╤ê╨╕╨▒╨║╨░ ╨┐╨░╤Ç╤ü╨╕╨╜╨│╨░ JSON ╨┤╨╗╤Å ╨╕╨╝╨┐╨╛╤Ç╤é╨░ ╨║╨░╨╗╨╕╨▒╤Ç╨╛╨▓╨║╨╕");
                             webServer.send(400, "application/json", "{\"success\":false,\"error\":\"Invalid JSON\"}");
                             return;
                         }
                         
                         // ╨ÿ╨╝╨┐╨╛╤Ç╤é╨╕╤Ç╤â╨╡╨╝ ╨┤╨░╨╜╨╜╤ï╨╡ ╨║╨░╨╗╨╕╨▒╤Ç╨╛╨▓╨║╨╕
                         String jsonData;
                         serializeJson(doc, jsonData);
                         success = gCalibrationService.importCalibrationFromJSON(jsonData);
                         
                         if (success) {
                             logSuccess("╨Ü╨░╨╗╨╕╨▒╤Ç╨╛╨▓╨║╨░ ╨╕╨╝╨┐╨╛╤Ç╤é╨╕╤Ç╨╛╨▓╨░╨╜╨░ ╤â╤ü╨┐╨╡╤ê╨╜╨╛");
                             
                             // ╨Æ╨║╨╗╤Ä╤ç╨░╨╡╨╝ ╨║╨╛╨╝╨┐╨╡╨╜╤ü╨░╤å╨╕╤Ä ╨▓ ╨║╨╛╨╜╤ä╨╕╨│╤â╤Ç╨░╤å╨╕╨╕
                             config.flags.compensationEnabled = true;
                             saveConfig();
                         } else {
                             logError("╨₧╤ê╨╕╨▒╨║╨░ ╨╕╨╝╨┐╨╛╤Ç╤é╨░ ╨║╨░╨╗╨╕╨▒╤Ç╨╛╨▓╨║╨╕");
                         }
                     } catch (...) {
                         logError("╨ÿ╤ü╨║╨╗╤Ä╤ç╨╡╨╜╨╕╨╡ ╨┐╤Ç╨╕ ╨╕╨╝╨┐╨╛╤Ç╤é╨╡ ╨║╨░╨╗╨╕╨▒╤Ç╨╛╨▓╨║╨╕");
                         success = false;
                     }

                     DynamicJsonDocument response(256);
                     response["success"] = success;
                     if (!success)
                     {
                         response["error"] = "Failed to import calibration";
                     } else {
                         response["message"] = "Calibration imported successfully";
                     }

                     String response_str;
                     serializeJson(response, response_str);
                     webServer.send(200, "application/json", response_str);
                 });

    webServer.on("/api/calibration/reset", HTTP_POST,
                 []()
                 {
                     logWebRequest("POST", "/api/calibration/reset", webServer.client().remoteIP().toString());
                     
                     // ╨ÿ╨í╨ƒ╨á╨É╨Æ╨¢╨ò╨¥╨₧: ╨á╨╡╨░╨╗╤î╨╜╨░╤Å ╤Ç╨╡╨░╨╗╨╕╨╖╨░╤å╨╕╤Å ╤ü╨▒╤Ç╨╛╤ü╨░ ╨║╨░╨╗╨╕╨▒╤Ç╨╛╨▓╨║╨╕
                     try {
                                              // ╨í╨▒╤Ç╨░╤ü╤ï╨▓╨░╨╡╨╝ ╨║╨░╨╗╨╕╨▒╤Ç╨╛╨▓╨╛╤ç╨╜╤ï╨╡ ╨┤╨░╨╜╨╜╤ï╨╡
                         gCalibrationService.resetCalibration();
                         
                         // ╨í╨▒╤Ç╨░╤ü╤ï╨▓╨░╨╡╨╝ ╤ä╨╕╨╗╤î╤é╤Ç╤ï
                         AdvancedFilters::resetAllFilters();
                         
                         // ╨¥╨ò ╤é╤Ç╨╛╨│╨░╨╡╨╝ ╤ä╨╗╨░╨│ ╨║╨╛╨╝╨┐╨╡╨╜╤ü╨░╤å╨╕╨╕! ╨Ü╨░╨╗╨╕╨▒╤Ç╨╛╨▓╨║╨░ ╨╕ ╨║╨╛╨╝╨┐╨╡╨╜╤ü╨░╤å╨╕╤Å - ╤Ç╨░╨╖╨╜╤ï╨╡ ╨▓╨╡╤ë╨╕
                         // config.flags.compensationEnabled ╨╛╤ü╤é╨░╨╡╤é╤ü╤Å ╨║╨░╨║ ╨╡╤ü╤é╤î
                         saveConfig();
                         
                         logSuccess("╨Ü╨░╨╗╨╕╨▒╤Ç╨╛╨▓╨║╨░ ╤â╤ü╨┐╨╡╤ê╨╜╨╛ ╤ü╨▒╤Ç╨╛╤ê╨╡╨╜╨░");
                         
                         DynamicJsonDocument response(128);
                         response["success"] = true;
                         response["message"] = "╨Ü╨░╨╗╨╕╨▒╤Ç╨╛╨▓╨║╨░ ╤ü╨▒╤Ç╨╛╤ê╨╡╨╜╨░ ╤â╤ü╨┐╨╡╤ê╨╜╨╛";

                         String response_str;
                         serializeJson(response, response_str);
                         webServer.send(200, "application/json", response_str);
                     } catch (...) {
                         logError("╨₧╤ê╨╕╨▒╨║╨░ ╨┐╤Ç╨╕ ╤ü╨▒╤Ç╨╛╤ü╨╡ ╨║╨░╨╗╨╕╨▒╤Ç╨╛╨▓╨║╨╕");
                         
                         DynamicJsonDocument response(128);
                         response["success"] = false;
                         response["error"] = "╨₧╤ê╨╕╨▒╨║╨░ ╨┐╤Ç╨╕ ╤ü╨▒╤Ç╨╛╤ü╨╡ ╨║╨░╨╗╨╕╨▒╤Ç╨╛╨▓╨║╨╕";

                         String response_str;
                         serializeJson(response, response_str);
                         webServer.send(500, "application/json", response_str);
                     }
                 });

    logDebug("╨£╨░╤Ç╤ê╤Ç╤â╤é╤ï ╨┤╨░╨╜╨╜╤ï╤à ╨╜╨░╤ü╤é╤Ç╨╛╨╡╨╜╤ï: /readings, /api/v1/sensor (json), /sensor_json [legacy], /api/calibration/*");
}
